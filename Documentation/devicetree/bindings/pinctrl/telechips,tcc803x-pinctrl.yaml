## Documentation/devicetree/bindings/sound/telechips,tcc803x-audio-chmux.yaml
```yaml
# SPDX-License-Identifier: (GPL-2.0-only OR BSD-2-Clause)
%YAML 1.2
---
$id: http://devicetree.org/schemas/sound/telechips,tcc803x-audio-chmux.yaml#
$schema: http://devicetree.org/meta-schemas/core.yaml#

title: Telechips TCC803x audio channel mux

maintainers:
  - William Floyd <git@notmy.space>

description: |
  The IOBUS configuration registers that route each DAI and SPDIF block to
  a pad port (vendor sound/soc/tcc_tcc803x/tcc_audio_chmux.[ch]). Written by
  the I2S driver through a syscon regmap.

select:
  properties:
    compatible:
      contains:
        const: telechips,tcc803x-audio-chmux
  required:
    - compatible

properties:
  compatible:
    items:
      - const: telechips,tcc803x-audio-chmux
      - const: syscon

  reg:
    maxItems: 1

required:
  - compatible
  - reg

additionalProperties: false

examples:
  - |
    syscon@16051000 {
        compatible = "telechips,tcc803x-audio-chmux", "syscon";
        reg = <0x16051000 0x98>;
    };
```

## Documentation/devicetree/bindings/sound/telechips,tcc803x-i2s.yaml
```yaml
# SPDX-License-Identifier: (GPL-2.0-only OR BSD-2-Clause)
%YAML 1.2
---
$id: http://devicetree.org/schemas/sound/telechips,tcc803x-i2s.yaml#
$schema: http://devicetree.org/meta-schemas/core.yaml#

title: Telechips TCC803x I2S transmitter with its ADMA

maintainers:
  - William Floyd <git@notmy.space>

description: |
  One audio block of the TCC803x: a DAI (I2S) and the ADMA that feeds it.
  Stereo playback, S16_LE, the SoC providing bit and frame clocks.
  Registers and sequence are from the vendor kernel's
  sound/soc/tcc_tcc803x/ (tcc_i2s.c, tcc_adma_pcm.c).

properties:
  compatible:
    const: telechips,tcc803x-i2s

  reg:
    items:
      - description: ADMA registers
      - description: DAI registers (ADMA base + 0x1000)

  reg-names:
    items:
      - const: adma
      - const: dai

  interrupts:
    maxItems: 1
    description: The ADMA interrupt

  clocks:
    maxItems: 4

  clock-names:
    items:
      - const: pclk
      - const: hclk
      - const: filter
      - const: adma

  telechips,chmux:
    $ref: /schemas/types.yaml#/definitions/phandle-array
    items:
      - items:
          - description: audio channel mux
          - description: DAI index (0-2 are 7.1ch blocks, 3-6 stereo)
          - description: pad port the block drives
    description: Which pad port this DAI is routed to.

  '#sound-dai-cells':
    const: 0

required:
  - compatible
  - reg
  - reg-names
  - interrupts
  - clocks
  - clock-names
  - telechips,chmux
  - '#sound-dai-cells'

additionalProperties: false

examples:
  - |
    #include <dt-bindings/interrupt-controller/arm-gic.h>
    #include <dt-bindings/clock/telechips,tcc803x-clks.h>

    i2s@16201000 {
        compatible = "telechips,tcc803x-i2s";
        reg = <0x16200000 0x200>, <0x16201000 0x58>;
        reg-names = "adma", "dai";
        interrupts = <GIC_SPI 82 IRQ_TYPE_LEVEL_HIGH>;
        clocks = <&sipclk TCC803X_SIPCLK_PERI_SRCH0_CORE>,
                 <&sipclk TCC803X_SIPCLK_IOBUS_SR_DAI0>,
                 <&sipclk TCC803X_SIPCLK_PERI_SRCH0_FILTER>,
                 <&sipclk TCC803X_SIPCLK_IOBUS_SR_ADMA0>;
        clock-names = "pclk", "hclk", "filter", "adma";
        telechips,chmux = <&audio_chmux 3 4>;
        #sound-dai-cells = <0>;
    };
```

## Documentation/devicetree/bindings/watchdog/telechips,tcc803x-wdt.yaml
```yaml
# SPDX-License-Identifier: (GPL-2.0-only OR BSD-2-Clause)
%YAML 1.2
---
$id: http://devicetree.org/schemas/watchdog/telechips,tcc803x-wdt.yaml#
$schema: http://devicetree.org/meta-schemas/core.yaml#

title: Telechips TCC803x PMU watchdog

maintainers:
  - William Floyd <git@notmy.space>

description: |
  The PMU watchdog belongs to the secure monitor: it is set up, started,
  stopped and pinged with SiP calls (SIP_DEV_WATCHDOG, 0x82002000 + n), not
  register writes. The vendor firmware starts it before the kernel runs, and a
  kernel that does not ping it is reset by the PMU, which also clears RAM. The
  node's reg is the timer watchdog's config, clear and count registers, which
  the driver switches off.

allOf:
  - $ref: watchdog.yaml#

properties:
  compatible:
    const: telechips,tcc803x-wdt

  reg:
    maxItems: 1

  clock-frequency:
    description:
      The PMU clock in Hz that the SETUP call's timeout is counted in.

  telechips,clear-bit:
    $ref: /schemas/types.yaml#/definitions/uint32
    description:
      The bit of the PING call's clear argument that clears the watchdog.
    maximum: 31
    default: 0

required:
  - compatible
  - reg
  - clock-frequency

unevaluatedProperties: false

examples:
  - |
    watchdog@14300070 {
        compatible = "telechips,tcc803x-wdt";
        reg = <0x14300070 0xc>;
        clock-frequency = <24000000>;
        telechips,clear-bit = <0>;
    };
```

## drivers/clk/telechips/Kconfig
```kconfig
# SPDX-License-Identifier: GPL-2.0-only

config COMMON_CLK_TCC803X
	bool "Clock driver for Telechips TCC803x CKC"
	depends on ARCH_TCC803X || COMPILE_TEST
	default ARCH_TCC803X
	help
	  Partial clock driver for the Telechips TCC803x CKC ("Clock
	  Controller"). Only the PERI_UART0 peripheral-clock gate is
	  implemented so far, enough to clock UART0; PLLs, bus clocks
	  and the other gate/reset arrays are not yet supported.
```

## drivers/gpu/drm/telechips/Kconfig
```kconfig
# SPDX-License-Identifier: GPL-2.0-only
config DRM_TCC803X
	tristate "DRM Support for Telechips TCC803x"
	depends on DRM && OF && ARM
	depends on ARCH_TCC803X || COMPILE_TEST
	select DRM_GEM_DMA_HELPER
	select DRM_KMS_HELPER
	select DRM_CLIENT_SELECTION
	select DRM_FBDEV_EMULATION
	select VIDEOMODE_HELPERS
	help
	  Top-level KMS driver that binds the TCC803x VIOC display
	  controller (CRTC/planes) and HDMI encoder/connector into a
	  single DRM device, with fbdev/fbcon emulation enabled so the
	  kernel console is usable on the physical display. This board
	  has no accessible UART, so this is the primary early-boot
	  debug console.

	  This driver only provides the integration glue; it requires
	  the VIOC and HDMI sub-drivers (selected separately) to be
	  present and bound as components for any output to appear.

	  If in doubt, say N.
```

## drivers/media/platform/chips-media/wave4/Kconfig
```kconfig
# SPDX-License-Identifier: GPL-2.0-only
config VIDEO_WAVE4_VPU
	tristate "Chips&Media Wave410 HEVC decoder"
	depends on V4L_MEM2MEM_DRIVERS
	depends on VIDEO_DEV && OF
	depends on ARCH_TCC803X || COMPILE_TEST
	select VIDEOBUF2_DMA_CONTIG
	select V4L2_MEM2MEM_DEV
	help
	  Stateful V4L2 decoder for the Chips&Media Wave410 HEVC decoder in
	  the Telechips TCC803x. It needs the firmware image that the vendor
	  ships inside its own kernel module.

	  To compile this driver as a module, choose M here: the module will
	  be called wave4.
```

## drivers/media/platform/telechips/Kconfig
```kconfig
# SPDX-License-Identifier: GPL-2.0-only

config VIDEO_TCC803X_REARVIEW
	tristate "Telechips TCC803x VIOC rear-view camera overlay"
	depends on V4L_PLATFORM_DRIVERS
	depends on VIDEO_DEV && OF && GPIOLIB
	depends on ARCH_TCC803X || COMPILE_TEST
	select V4L2_ASYNC
	select V4L2_FWNODE
	select VIDEO_V4L2_SUBDEV_API
	help
	  Captures an analog camera decoder through the TCC803x VIOC and
	  overlays it on the display's WMIX0 while the reverse-gear GPIO is
	  active or userspace asks for it. Untested on hardware.
```

## drivers/phy/telechips/Kconfig
```kconfig
# SPDX-License-Identifier: GPL-2.0-only
#
# Phy drivers for Telechips platforms
#
config PHY_TCC803X_USB_OTG
	tristate "Telechips TCC803x USB OTG PHY driver"
	depends on ARCH_TCC803X || COMPILE_TEST
	depends on OF && HAS_IOMEM
	select GENERIC_PHY
	help
	  Enable this to support the HS PHY behind the TCC803x DWC2 OTG core,
	  used to run the USB-A port in peripheral (gadget) mode.
```

## drivers/pinctrl/telechips/Kconfig
```kconfig
# SPDX-License-Identifier: GPL-2.0-only
config PINCTRL_TCC803X
	bool "Telechips TCC803x pin controller driver"
	depends on ARCH_TCC803X || COMPILE_TEST
	depends on OF
	select GENERIC_PINCONF
	select PINMUX
	default ARCH_TCC803X
	help
	  Pin controller and GPIO driver for the Telechips TCC803x SoC.
	  Covers only pin banks GPA..GPSD1 (see the driver for why); pinconf
	  covers bias, input enable and schmitt, not drive strength or slew
	  rate.
```

## drivers/soc/telechips/Kconfig
```kconfig
# SPDX-License-Identifier: GPL-2.0-only

config TCC803X_CM4
	bool "Telechips TCC803x Cortex-M4 early-camera stop"
	depends on ARCH_TCC803X || COMPILE_TEST
	depends on COMMON_CLK && OF
	default ARCH_TCC803X
	help
	  Stops the rear-camera firmware the bootloader leaves running on the
	  TCC803x Cortex-M4 and holds the core in reset, so the kernel's own
	  display and camera drivers own the blocks it would otherwise keep
	  driving.
```

## drivers/usb/typec/maxim/Kconfig
```kconfig
# SPDX-License-Identifier: GPL-2.0

config TYPEC_MAX77705
	tristate "Maxim MAX77705 USB Type-C port driver"
	depends on MFD_MAX77705
	depends on I2C
	depends on USB_ROLE_SWITCH || !USB_ROLE_SWITCH
	select DRM_AUX_HPD_BRIDGE if DRM_BRIDGE && OF
	select REGMAP_I2C
	help
	  Say Y or M here to enable the USB Type-C port of the Maxim MAX77705
	  companion PMIC, found in Samsung Galaxy phones from the S9 onwards.

	  The chip runs the Type-C and USB-PD state machines in firmware, so
	  this driver reports the connection it establishes and drives the
	  orientation and USB role switches to match, rather than implementing
	  power delivery itself.

	  If compiled as a module, the module will be called max77705-typec.
```

## sound/soc/telechips/Kconfig
```kconfig
# SPDX-License-Identifier: GPL-2.0-only
config SND_SOC_TCC803X_I2S
	tristate "Telechips TCC803x I2S playback (ADMA)"
	depends on ARCH_TCC803X || COMPILE_TEST
	depends on HAS_IOMEM && COMMON_CLK
	select MFD_SYSCON
	help
	  Stereo I2S transmit through the TCC803x audio DMA (ADMA) and DAI
	  blocks. Playback only, 16-bit, I2S master. Use it with
	  simple-audio-card and a dummy transmitter ("linux,spdif-dit"); see
	  Documentation/devicetree/bindings/sound/telechips,tcc803x-i2s.yaml.
```
