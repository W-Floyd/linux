## Documentation/devicetree/bindings/pinctrl/telechips,tcc803x-pinctrl.yaml
```yaml
# SPDX-License-Identifier: (GPL-2.0-only OR BSD-2-Clause)
%YAML 1.2
---
$id: http://devicetree.org/schemas/pinctrl/telechips,tcc803x-pinctrl.yaml#
$schema: http://devicetree.org/meta-schemas/core.yaml#

title: Telechips TCC803x Pin Controller / GPIO

maintainers:
  - William Floyd <git@notmy.space>

description: |
  The TCC803x pin controller handles pin multiplexing, GPIO and (on some
  pins) basic pin configuration for the SoC's GPA..GPSD2/GPH/GPK/GPMA pin
  banks. Each bank is a fixed-offset block of registers starting at
  0x14200000; a separate, smaller "PM GPIO" block for the always-on domain
  exists at 0x14800800.

  CAVEAT: this binding and its driver currently cover only the pin banks
  whose registers fall inside the first 0x300-byte reg window (GPA through
  GPSD1). The vendor's own devicetree declares that same 0x300-byte window
  for this node while its own driver computes register offsets for
  GPSD2/GPH/GPK/GPMA as far out as +0x6c0 -- outside that window. That
  inconsistency is unresolved in the vendor source itself and is not
  carried into this binding; those banks are deliberately left
  undocumented/unsupported here until it is.

properties:
  compatible:
    const: telechips,tcc803x-pinctrl

  reg:
    items:
      - description: Main GPIO/pinmux register block (banks GPA..GPSD1)
      - description: PM-domain GPIO register block (always-on bank)

  gpio-controller: true

  "#gpio-cells":
    const: 2

  interrupts:
    description:
      Per-pin external-interrupt lines, routed through a shared mux
      (EINTSEL) rather than one line per GPIO.
    minItems: 1
    maxItems: 15

required:
  - compatible
  - reg
  - gpio-controller
  - "#gpio-cells"

patternProperties:
  "-grp$":
    type: object
    additionalProperties: false
    description:
      A pin group assigning one function to a list of pins.

    properties:
      telechips,pins:
        $ref: /schemas/types.yaml#/definitions/string-array
        description:
          Pin names in "<bank>-<pin>" form, e.g. "gpsd0-11".

      telechips,pin-function:
        $ref: /schemas/types.yaml#/definitions/uint32
        description:
          Raw 4-bit function-select value written to that pin's FUNC field.
          There is no symbolic name for these in vendor source beyond the
          raw integer; see the driver for the one value currently known
          (UART0, 7).

    required:
      - telechips,pins
      - telechips,pin-function

additionalProperties: false

examples:
  - |
    pinctrl@14200000 {
        compatible = "telechips,tcc803x-pinctrl";
        reg = <0x14200000 0x300>, <0x14800800 0x100>;
        gpio-controller;
        #gpio-cells = <2>;

        uart0_grp: uart0-grp {
            telechips,pins = "gpsd0-11", "gpsd0-12";
            telechips,pin-function = <7>;
        };
    };
...
```

## Documentation/devicetree/bindings/power/reset/telechips,tcc803x-reboot-mode.yaml
```yaml
# SPDX-License-Identifier: (GPL-2.0-only OR BSD-2-Clause)
%YAML 1.2
---
$id: http://devicetree.org/schemas/power/reset/telechips,tcc803x-reboot-mode.yaml#
$schema: http://devicetree.org/meta-schemas/core.yaml#

title: Telechips TCC803x reboot mode

maintainers:
  - William Floyd <git@notmy.space>

description:
  The TCC803x reset reason is a secure register kept across the reset by the
  secure monitor, which the bootloader reads back to choose the boot path.
  The node carries no registers; the magic is written with a SiP SMC.

allOf:
  - $ref: reboot-mode.yaml#

properties:
  compatible:
    const: telechips,tcc803x-reboot-mode

required:
  - compatible

unevaluatedProperties: false

examples:
  - |
    reboot-mode {
        compatible = "telechips,tcc803x-reboot-mode";
        mode-normal = <0x77665501>;
        mode-fastboot = <0x77665500>;
        mode-recovery = <0x77665502>;
    };
...
```

## Documentation/devicetree/bindings/power/supply/bq25890.yaml
```yaml
# SPDX-License-Identifier: GPL-2.0
# Copyright (C) 2021 Sebastian Reichel
%YAML 1.2
---
$id: http://devicetree.org/schemas/power/supply/bq25890.yaml#
$schema: http://devicetree.org/meta-schemas/core.yaml#

title: Bq25890, bq25892, bq25895, bq25896 and sc89890h Li-Ion Charger

maintainers:
  - Sebastian Reichel <sre@kernel.org>

allOf:
  - $ref: power-supply.yaml#

properties:
  compatible:
    oneOf:
      - enum:
          - ti,bq25890
            # The Southchip sc89890h is register-compatible with the bq25890
            # but not value-compatible: several fields have a different base
            # and step. It must therefore not fall back to ti,bq25890.
          - southchip,sc89890h
      - items:
          - enum:
              - ti,bq25892
              - ti,bq25895
              - ti,bq25896
          - const: ti,bq25890

  reg:
    maxItems: 1

  interrupts:
    maxItems: 1

  battery-temperature-supply:
    $ref: /schemas/types.yaml#/definitions/phandle
    description:
      Power supply, typically a fuel gauge, that measures the battery pack
      temperature. Boards that do not wire the charger's TS pin to the pack
      thermistor should name it here, so that the battery temperature this
      charger reports is the real one rather than an artefact of whatever the
      unconnected pin floats to. When absent, the TS pin is used.

  ti,battery-regulation-voltage:
    $ref: /schemas/types.yaml#/definitions/uint32
    description: maximum charging voltage (in uV)

  ti,charge-current:
    $ref: /schemas/types.yaml#/definitions/uint32
    description: maximum charging current (in uA)

  ti,termination-current:
    $ref: /schemas/types.yaml#/definitions/uint32
    description: |
      charge will be terminated when current in constant-voltage phase
      drops below this value (in uA)

  ti,precharge-current:
    $ref: /schemas/types.yaml#/definitions/uint32
    description: maximum charge current during precharge phase (in uA)

  ti,minimum-sys-voltage:
    $ref: /schemas/types.yaml#/definitions/uint32
    description: |
      when battery is charging and it is below minimum system voltage,
      the system will be regulated above minimum-sys-voltage setting (in uV)

  ti,boost-voltage:
    $ref: /schemas/types.yaml#/definitions/uint32
    description: VBUS voltage level in boost mode (in uV)

  ti,boost-max-current:
    $ref: /schemas/types.yaml#/definitions/uint32
    description: maximum allowed current draw in boost mode (in uA)

  ti,boost-low-freq:
    description: boost mode frequency will be 500kHz, otherwise 1.5MHz
    type: boolean

  ti,use-ilim-pin:
    description: |
      ILIM resistor will be used and the input current will be the lower
      between the resistor setting and the IINLIM register setting
    type: boolean

  ti,thermal-regulation-threshold:
    $ref: /schemas/types.yaml#/definitions/uint32
    description: |
      temperature above which the charge current is lowered, to avoid overheating
      (in degrees Celsius). If omitted, the default setting will be used (120 degrees)

  ti,ibatcomp-micro-ohms:
    description: value of a resistor in series with the battery (in Micro Ohms)

  ti,ibatcomp-clamp-microvolt:
    description: max. charging voltage adjustment due to expected voltage drop on in-series resistor

required:
  - compatible
  - reg
  - interrupts
  - ti,battery-regulation-voltage
  - ti,charge-current
  - ti,termination-current
  - ti,precharge-current
  - ti,minimum-sys-voltage
  - ti,boost-voltage
  - ti,boost-max-current

unevaluatedProperties: false

examples:
  - |
    #include <dt-bindings/interrupt-controller/irq.h>
    i2c {
      #address-cells = <1>;
      #size-cells = <0>;

      charger@6a {
        compatible = "ti,bq25890";
        reg = <0x6a>;

        interrupt-parent = <&gpio1>;
        interrupts = <16 IRQ_TYPE_EDGE_FALLING>;

        ti,battery-regulation-voltage = <4200000>;
        ti,charge-current = <1000000>;
        ti,termination-current = <50000>;
        ti,precharge-current = <128000>;
        ti,minimum-sys-voltage = <3600000>;
        ti,boost-voltage = <5000000>;
        ti,boost-max-current = <1000000>;

        ti,use-ilim-pin;
        ti,thermal-regulation-threshold = <120>;
      };
    };
```

## Documentation/devicetree/bindings/regulator/ti,tps61280.yaml
```yaml
# SPDX-License-Identifier: (GPL-2.0-only OR BSD-2-Clause)
%YAML 1.2
---
$id: http://devicetree.org/schemas/regulator/ti,tps61280.yaml#
$schema: http://devicetree.org/meta-schemas/core.yaml#

title: TI TPS61280 boost converter with bypass

maintainers:
  - William Floyd <git@notmy.space>

description: |
  Single-channel synchronous boost converter with an I2C interface and a
  pass-through (bypass) mode. The output is programmable from 2.85 V to
  4.4 V in 50 mV steps through two registers, VOUTFLOOR and VOUTROOF, and
  the VSEL pin selects which of the two is in effect. The EN pin enables the
  converter and the nBYP pin forces pass-through; both can be strapped on the
  board or driven by the host.

allOf:
  - $ref: regulator.yaml#

properties:
  compatible:
    oneOf:
      - const: ti,tps61280
      - items:
          - const: ti,tps61280a
          - const: ti,tps61280

  reg:
    maxItems: 1

  enable-gpios:
    maxItems: 1
    description:
      GPIO connected to the EN pin. Without it the converter is enabled and
      disabled through the CONFIG register instead.

  ti,vsel-gpios:
    maxItems: 1
    description:
      GPIO connected to the VSEL pin, which selects VOUTROOF (high) or
      VOUTFLOOR (low) as the active output register.

  ti,vsel-state-high:
    type: boolean
    description:
      The level of the VSEL pin. When ti,vsel-gpios is present the pin is
      driven to this level; otherwise it is the level the pin is strapped
      to. Without this property the pin is low and VOUTFLOOR is in effect.

  ti,bypass-gpios:
    maxItems: 1
    description:
      GPIO connected to the nBYP pin, active when the converter is in
      pass-through mode. The pin is active low, so describe it with
      GPIO_ACTIVE_LOW.

required:
  - compatible
  - reg

unevaluatedProperties: false

examples:
  - |
    #include <dt-bindings/gpio/gpio.h>
    #include <dt-bindings/regulator/ti,tps61280.h>

    i2c {
        #address-cells = <1>;
        #size-cells = <0>;

        regulator@75 {
            compatible = "ti,tps61280a", "ti,tps61280";
            reg = <0x75>;

            regulator-name = "vdd_pa";
            regulator-min-microvolt = <3500000>;
            regulator-max-microvolt = <4200000>;
            regulator-initial-mode = <TPS61280_MODE_NORMAL>;

            enable-gpios = <&tlmm 60 GPIO_ACTIVE_HIGH>;
            ti,vsel-gpios = <&tlmm 52 GPIO_ACTIVE_HIGH>;
            ti,vsel-state-high;
            ti,bypass-gpios = <&tlmm 59 GPIO_ACTIVE_LOW>;
        };
    };
...
```

## Documentation/devicetree/bindings/rtc/telechips,tcc803x-rtc.yaml
```yaml
# SPDX-License-Identifier: (GPL-2.0-only OR BSD-2-Clause)
%YAML 1.2
---
$id: http://devicetree.org/schemas/rtc/telechips,tcc803x-rtc.yaml#
$schema: http://devicetree.org/meta-schemas/core.yaml#

title: Telechips TCC803x Real Time Clock

maintainers:
  - William Floyd <william.floyd@modopayments.com>

description:
  The block's clock gates belong to the secure monitor and are driven by the
  driver through SiP SMC calls, so the node has no clocks property.

allOf:
  - $ref: rtc.yaml#

properties:
  compatible:
    const: telechips,tcc803x-rtc

  reg:
    maxItems: 1

  interrupts:
    maxItems: 1

required:
  - compatible
  - reg

unevaluatedProperties: false

examples:
  - |
    #include <dt-bindings/interrupt-controller/arm-gic.h>

    rtc@16480000 {
        compatible = "telechips,tcc803x-rtc";
        reg = <0x16480000 0x50>;
        interrupts = <GIC_SPI 73 IRQ_TYPE_LEVEL_HIGH>;
    };
```

## Documentation/devicetree/bindings/soc/qcom/motorola,mmi-unit-info.yaml
```yaml
# SPDX-License-Identifier: (GPL-2.0-only OR BSD-2-Clause)
%YAML 1.2
---
$id: http://devicetree.org/schemas/soc/qcom/motorola,mmi-unit-info.yaml#
$schema: http://devicetree.org/meta-schemas/core.yaml#

title: Motorola unit info for the modem

maintainers:
  - William Floyd <git@notmy.space>

description:
  Motorola's modem firmware takes its RF hardware id from a unit info block
  the application processor publishes in SMEM item 134 before the modem
  boots. Motorola's bootloader passes the values as androidboot.device and
  androidboot.radio kernel arguments to its own kernels; a mainline kernel
  receives neither. The device name is described here; the radio SKU is
  detected per unit by the bootloader on some boards (from a hardware id)
  and is then supplied by the OS instead.

properties:
  compatible:
    const: motorola,mmi-unit-info

  motorola,device:
    $ref: /schemas/types.yaml#/definitions/string
    description: Device codename, as in androidboot.device.

  motorola,radio:
    $ref: /schemas/types.yaml#/definitions/string
    description:
      Radio SKU, as in androidboot.radio. Only for boards built in a single
      radio variant; where the bootloader detects it per unit, leave it out
      and let the OS supply the detected value before the modem boots.

  motorola,carrier:
    $ref: /schemas/types.yaml#/definitions/string
    description: Carrier, as in androidboot.carrier. Not needed by all modems.

required:
  - compatible
  - motorola,device

additionalProperties: false

examples:
  - |
    mmi-unit-info {
        compatible = "motorola,mmi-unit-info";
        motorola,device = "fogona";
    };
```

## Documentation/devicetree/bindings/soc/telechips/telechips,tcc803x-cm4.yaml
```yaml
# SPDX-License-Identifier: (GPL-2.0-only OR BSD-2-Clause)
%YAML 1.2
---
$id: http://devicetree.org/schemas/soc/telechips/telechips,tcc803x-cm4.yaml#
$schema: http://devicetree.org/meta-schemas/core.yaml#

title: Telechips TCC803x Cortex-M4 subsystem

maintainers:
  - William Floyd <git@notmy.space>

description: |
  The Cortex-M4 beside the application cores, with its own code and data
  SRAM. It runs either the SoC's secure-processor firmware or, when the
  bootloader starts it, the early rear camera; the kernel stops the latter
  through the mailbox and holds the core in reset.

properties:
  compatible:
    const: telechips,tcc803x-cm4

  reg:
    items:
      - description: Application-core side of the mailbox to the M4
      - description: M4 configuration (reset, IRQ routing, remap)
      - description: M4 code SRAM

  reg-names:
    items:
      - const: mbox
      - const: cfg
      - const: code

  clocks:
    maxItems: 1
    description: The M4 bus clock (CLKCTRL 3)

required:
  - compatible
  - reg
  - reg-names
  - clocks

additionalProperties: false

examples:
  - |
    cortex-m4@19000000 {
        compatible = "telechips,tcc803x-cm4";
        reg = <0x19000000 0x50>, <0x19100000 0x48>, <0x19080000 0x10000>;
        reg-names = "mbox", "cfg", "code";
        clocks = <&fbus 3>;
    };
```
