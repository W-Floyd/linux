## Documentation/devicetree/bindings/display/telechips/telechips,tcc803x-output-config.yaml
```yaml
# SPDX-License-Identifier: (GPL-2.0-only OR BSD-2-Clause)
%YAML 1.2
---
$id: http://devicetree.org/schemas/display/telechips/telechips,tcc803x-output-config.yaml#
$schema: http://devicetree.org/meta-schemas/core.yaml#

title: Telechips TCC803x VIOC output-config (OUTCFG) block

maintainers:
  - William Floyd <git@notmy.space>

description: |
  Routing mux between the SoC's DISP0/DISP1/DISP2 timing-generator
  outputs and its physical output interfaces (HDMI, SD/HD video encoder,
  an MCU-style 8080 parallel panel interface, and a synchronous parallel
  RGB panel interface). Confirmed real and at this exact address by the
  vendor driver (AVNT5W_TCC803XKK_kernel):

    arch/arm/mach-tcc803x/vioc/vioc_outcfg.c: vioc_outputconfig_init()
    (arch_initcall) does
    of_find_compatible_node(NULL, NULL, "telechips,output_config")
    then of_iomap(np, 0) -- same compatible string and reg window as
    the pre-existing arch/arm/boot/dts/mobis/tcc803x.dtsi:2306-2309
    node this binding now documents formally.

  Register layout (include/video/tcc/vioc_outcfg.h, struct VIOC_OUTCFG,
  4 x 32-bit words = the 0x10 reg size):

    0x00  D0CPUIF   CPU/MCU-interface control for a panel driven
                     directly off DISP0 (bitfields: FMT, XA, CS, SI,
                     EN, IV, ID -- not decoded further here, only the
                     offset is confirmed real).
    0x04  D1CPUIF   Same, for DISP1.
    0x08  D2CPUIF   Same, for DISP2.
    0x0C  MISCCFG   Output-type routing mux, 5 x 2-bit SEL fields,
                     each selecting which DISP (0/1/2; 3 = reserved/
                     "V_DV") feeds that physical output type:
                       bits [1:0]   HDMISEL  (HDMI TX)
                       bits [5:4]   SDVESEL  (SD video encoder /
                                              composite)
                       bits [9:8]   HDVESEL  (HD video encoder /
                                              component)
                       bits [13:12] M80SEL   (MCU/8080 parallel
                                              interface)
                       bits [17:16] MRGBSEL  (synchronous parallel
                                              RGB interface)
                     Set by VIOC_OUTCFG_SetOutConfig(type, disp) in
                     vioc_outcfg.c, which does exactly this
                     read-modify-write (tcc_vioc_bitcset) per type;
                     bit positions above are taken directly from that
                     function's shift amounts (0, 4, 8, 12, 16), which
                     match the VIOC_OUTCFG_MISC bitfield struct in
                     vioc_outcfg.h.

  What still is NOT confirmed from static vendor source alone, and
  would need a live register read (not attempted here) or a board-init
  call site this tree doesn't have, to settle:

    - Which output type the real DISP0-fed main panel uses. HDMI,
      SDVENC and HDVENC are external video-format outputs, not
      appropriate for a directly-driven LCD; M80 is a command-mode MCU
      panel interface; MRGB is the standard synchronous parallel-RGB
      panel interface and is the only structurally-plausible fit for a
      conventional LCD panel among the five -- but VIOC_OUTCFG_MRGB is
      only ever *defined* in this vendor tree (include/video/tcc/
      vioc_outcfg.h:37 and duplicates), never passed to
      VIOC_OUTCFG_SetOutConfig() by any board/driver file found here.
      The only call site located (drivers/video/fbdev/tcc-fb/
      tcc_vioc_fb.c:1033) hardcodes VIOC_OUTCFG_HDMI for an external
      display path, not the main panel. It is possible the main panel
      needs no explicit SetOutConfig() call at all, if MISCCFG's
      power-on-reset value already selects DISP0 (SEL field value 0)
      for every output type -- plausible but not verified against a
      reset-value table in the extracted source.

      Follow-up (exhaustive grep of every VIOC_OUTCFG_SetOutConfig()
      caller in AVNT5W_TCC803XKK_kernel) confirms the above: MRGB (4)
      is never an argument anywhere in the tree; every call site passes
      HDMI, SDVENC or HDVENC. Structural counterpoint worth recording:
      the only other board in this same vendor tree with a comparable
      1920x720 panel (tianma TM123XDHP90, drivers/video/fbdev/tcc-fb/
      lcd_TM123XDHP90.c, "telechips,lvds-tm123xdhp90",
      arch/arm/boot/dts/tcc/tcc8030-android-lpd4321_sv0.1.dts:138-152)
      is LVDS off DISP0, not off DISP1 as earlier noted here -- that
      board's own file carries zero fbdisplay/DISP references; it
      `#include`s the real AVN board's own base dtsi,
      arch/arm/boot/dts/mobis/tcc8031-android-avn.dtsi, unmodified, and
      that dtsi's `fbdisplay@12000000` node sets
      `telechips,fbdisplay_num = <0>` (read directly as the DISP
      controller index -- `lcdc_number`/`nr_disp` -- by every consumer
      checked: drivers/video/fbdev/tcc-fb/tcc_vioc_fb.c:2526,
      drivers/gpu/drm/tcc/tcc_drm_lcd.c:787). So DISP0 is confirmed,
      independent of MRGB-vs-LVDS, for the main panel on this exact
      board family -- the earlier DISP1 attribution here conflated this
      with unrelated VIOC_DISP1 references in that same vendor tree's
      video/VIQE sub-pipeline nodes (PIP/overlay scaling paths, not the
      main panel). What remains genuinely unresolved is LVDS vs MRGB,
      not which DISP. The real AVN board file also names
      `lvds_variant_check-gpio` and `digital_variant_check-gpio` side
      by side in its `mobis-gpio-pinctrl` node
      (arch/arm/boot/dts/mobis/tcc8031-android-avn.dtsi:~890), implying
      two real production panel variants selected/detected at
      board/runtime level -- LVDS (via the SoC's on-die
      `lvds_phy@12370000`, clocked by `PERI_LVDS_PHY`, tcc803x.dtsi:
      2266-2271, with a complete working driver,
      lcd_TM123XDHP90.c) and a "digital" variant that is more likely
      DISP0's own native parallel-RGB pins driven directly (no
      MISCCFG/MRGBSEL involved at all) than the MISCCFG-routed MRGB aux
      path documented above, since that path has zero consumers
      anywhere in the vendor tree. See telechips,tcc803x-mrgb-panel.yaml
      for the MRGB panel node this mux feeds and its own caveat section
      on why MRGB routing here is grounded in a live register read
      (outside this static-source investigation), not vendor-source
      precedent. Resolving LVDS vs MRGB/digital for this specific unit
      needs either a live read of lvds_variant_check-gpio /
      digital_variant_check-gpio, or confirmation of whether DISP0's
      pixel stream reaches the panel through the lvds_phy block.
    - MISCCFG's live/current value on real hardware: not read here.
    - D0CPUIF/D1CPUIF/D2CPUIF bitfields beyond their offsets: not
      decoded, since no caller of VIOC_OUTCFG_SetOutConfig() in this
      vendor tree touches them (only MISCCFG is written by that
      function).

properties:
  compatible:
    const: telechips,output_config

  reg:
    maxItems: 1

required:
  - compatible
  - reg

additionalProperties: false

examples:
  - |
    output_config: output-config@12100200 {
        compatible = "telechips,output_config";
        reg = <0x12100200 0x10>;
    };
```

## Documentation/devicetree/bindings/display/telechips/telechips,tcc803x-vioc-config.yaml
```yaml
# SPDX-License-Identifier: (GPL-2.0-only OR BSD-2-Clause)
%YAML 1.2
---
$id: http://devicetree.org/schemas/display/telechips/telechips,tcc803x-vioc-config.yaml#
$schema: http://devicetree.org/meta-schemas/core.yaml#

title: Telechips TCC803x VIOC shared configuration/IRQ-demux block

maintainers:
  - William Floyd <git@notmy.space>

description: |
  A syscon-like register block shared by every VIOC RDMA/WMIX/DISP/WDMA
  channel: per-channel IRQ-select registers (offsets 0x0D8 RDMA, 0x0DC
  WMIX, confirmed by the vendor's own per-channel node reg lists --
  arch/arm/boot/dts/mobis/tcc803x.dtsi:1995 lists a channel's own window
  plus "0x1200A0D8 0x4", which is vioc-config's base 0x1200a000 + 0x0d8),
  software-reset bits (vioc_wmix.c:537-543, VIOC_WMIX_SetSWReset reads
  this block via VIOC_IREQConfig_GetAddress()), and RDMA-to-WMIX/path
  routing muxes used by the full 18-RDMA/7-WMIX/8-scaler VIOC fabric.

  Base address and size confirmed: arch/arm/boot/dts/mobis/tcc803x.dtsi:
  2271-2274 (vioc_config@1200a000, reg size 0x1000).

  Not yet consumed by any driver in this tree: the minimal single-RDMA/
  single-WMIX/single-DISP path (telechips,tcc803x-vioc-plane and
  telechips,tcc803x-vioc-crtc) does not reference this node, since a
  single fixed RDMA0->WMIX0->DISP0 path needs no runtime routing or IRQ
  demux to put a static image on screen. This binding documents the
  block's existence and real address for whichever driver (VIQE,
  scaler, multi-plane overlay, or IRQ-cause demux for vblank) needs it
  next.

properties:
  compatible:
    const: telechips,tcc803x-vioc-config

  reg:
    maxItems: 1

required:
  - compatible
  - reg

additionalProperties: false

examples:
  - |
    vioc_config: vioc-config@1200a000 {
        compatible = "telechips,tcc803x-vioc-config";
        reg = <0x1200a000 0x1000>;
    };
```

## Documentation/devicetree/bindings/display/telechips/telechips,tcc803x-vioc-crtc.yaml
```yaml
# SPDX-License-Identifier: (GPL-2.0-only OR BSD-2-Clause)
%YAML 1.2
---
$id: http://devicetree.org/schemas/display/telechips/telechips,tcc803x-vioc-crtc.yaml#
$schema: http://devicetree.org/meta-schemas/core.yaml#

title: Telechips TCC803x VIOC WMIX+DISP (DRM CRTC)

maintainers:
  - William Floyd <git@notmy.space>

description: |
  A TCC803x VIOC display path's compositing/timing pair: one WMIX
  ("window mixer", the compositor that overlays up to 4 RDMA inputs) and
  the DISP0 timing/sync-generator it feeds. Modeled as a single DRM CRTC
  node with two named register windows, since mainline's atomic KMS
  model has no separate "mixer" object between planes and a CRTC -- the
  WMIX's compositing role and DISP's timing-generator role are both
  folded into this one CRTC's enable/disable and mode_set hooks.

  Register layout confirmed against the real vendor Linux 3.18 tree
  (AVNT5W_TCC803XKK_kernel, Hyundai Mobis supplier-portal release,
  Telechips Inc., GPLv2):
    arch/arm/mach-tcc803x/include/mach/vioc_wmix.h:231-258 (WMIX register
      map; CTRL.OVP bits[4:0] selects overlay/stacking order of up to 4
      RDMA input layers, CTRL.UPD bit16 latches pending writes)
    arch/arm/mach-tcc803x/vioc/vioc_wmix.c:41-57 (OVP/UPD bit access)
    arch/arm/mach-tcc803x/include/mach/vioc_disp.h:424-452 (DISP register
      map; CTRL bit0 is the display-enable "LEN" bit, uLSIZE at offset
      0x04c packs (height<<16)|width)
    arch/arm/mach-tcc803x/vioc/vioc_disp.c:431-435 (VIOC_DISP_TurnOn/Off
      just set/clear CTRL bit0)
    arch/arm/boot/dts/mobis/tcc803x.dtsi:2102-2106 (WMIX0 base address
      0x12001800), :2312-2318 (DISP0 base address 0x12000000)

  NOT modeled here, and required before this can drive real video
  timing: the DISP horizontal/vertical timing registers (LHTIME1/2,
  LVTIME1/2 at offsets 0x00c/0x010/0x014/0x018) and pixel-clock divider
  (LCLKDIV at 0x008) need real mode-timing values. The DDIBUS_VIOC/
  PERI_LCD0 gates below only enable the bus and peripheral clocks this
  path runs on; they don't configure pixel-clock rate or timing.

properties:
  compatible:
    const: telechips,tcc803x-vioc-crtc

  reg:
    items:
      - description: WMIX0 register window
      - description: DISP0 register window

  reg-names:
    items:
      - const: wmix
      - const: disp

  interrupts:
    maxItems: 1
    description: Shared VIOC bus-0 interrupt (VIOC0_IRQI = SPI 151; vendor
      header cites 119, contradicted by live recon -- see
      telechips,tcc803x-vioc-plane.yaml).

  clocks:
    items:
      - description: DDIBUS_VIOC display-bus gate
      - description: PERI_LCD0 peripheral-clock gate

  clock-names:
    items:
      - const: ddi
      - const: disp0

  telechips,planes:
    $ref: /schemas/types.yaml#/definitions/phandle-array
    description: |
      RDMA plane(s) (telechips,tcc803x-vioc-plane nodes) wired to this
      WMIX's input layers. Order matches the WMIX's own layer 0..3
      inputs; only layer 0 need be populated for a single-plane path.

  port:
    $ref: /schemas/graph.yaml#/properties/port
    description: |
      Output endpoint connected to the downstream bridge (e.g. hdmi_tx)
      this CRTC's driver resolves with devm_drm_of_get_bridge() and
      drm_bridge_attach()s to its own CRTC-owned encoder. The bridge is
      not itself a component (see telechips,tcc803x-hdmi.yaml); this
      graph link is how the CRTC driver finds it instead.

required:
  - compatible
  - reg
  - reg-names
  - interrupts
  - telechips,planes

additionalProperties: false

examples:
  - |
    #include <dt-bindings/interrupt-controller/arm-gic.h>
    vioc_crtc0: vioc-crtc@12001800 {
        compatible = "telechips,tcc803x-vioc-crtc";
        reg = <0x12001800 0x100>, <0x12000000 0x100>;
        reg-names = "wmix", "disp";
        interrupts = <GIC_SPI 151 IRQ_TYPE_LEVEL_HIGH>;
        clocks = <&ckc 128>, <&ckc 9>;
        clock-names = "ddi", "disp0";
        telechips,planes = <&vioc_rdma0>;
    };
```
