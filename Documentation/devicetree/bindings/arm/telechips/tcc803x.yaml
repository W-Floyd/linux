## Documentation/devicetree/bindings/mfd/samsung,s2mpb02.yaml
```yaml
# SPDX-License-Identifier: (GPL-2.0 OR BSD-2-Clause)
%YAML 1.2
---
$id: http://devicetree.org/schemas/mfd/samsung,s2mpb02.yaml#
$schema: http://devicetree.org/meta-schemas/core.yaml#

title: Samsung S2MPB02 Power Management IC

maintainers:
  - William Floyd <git@notmy.space>

description:
  The S2MPB02 is a companion power management IC for the camera sensors in
  smart phones. It provides eighteen LDO regulators, two bucks and a
  buck-boost, along with a two-channel flash/torch LED controller. It is
  typically reached over a dedicated I2C bus rather than the main PMIC bus.

properties:
  compatible:
    const: samsung,s2mpb02

  reg:
    maxItems: 1

  regulators:
    type: object
    patternProperties:
      "^(ldo([1-9]|1[0-8])|buck[12]|bb)$":
        type: object
        $ref: /schemas/regulator/regulator.yaml#
        unevaluatedProperties: false

        required:
          - regulator-name

    additionalProperties: false

  leds:
    type: object
    additionalProperties: false

    description:
      The two FLED channels. Each drives one LED with an independent
      current, mode and hardware timeout, and can be strobed either over
      I2C or through its own pair of FLASH_EN and TORCH_EN pins.

    properties:
      "#address-cells":
        const: 1

      "#size-cells":
        const: 0

    patternProperties:
      "^led@[01]$":
        type: object
        $ref: /schemas/leds/common.yaml#
        unevaluatedProperties: false

        properties:
          reg:
            description: Index of the FLED channel.
            minimum: 0
            maximum: 1

          led-max-microamp:
            minimum: 20000
            maximum: 300000

          flash-max-microamp:
            minimum: 100000
            maximum: 1500000

          flash-max-timeout-us:
            minimum: 62500
            maximum: 1000000

        required:
          - reg

    required:
      - "#address-cells"
      - "#size-cells"

required:
  - compatible
  - reg
  - regulators

additionalProperties: false

examples:
  - |
    #include <dt-bindings/leds/common.h>

    i2c {
        #address-cells = <1>;
        #size-cells = <0>;

        pmic@59 {
            compatible = "samsung,s2mpb02";
            reg = <0x59>;

            regulators {
                ldo5 {
                    regulator-name = "cam_vdig";
                    regulator-min-microvolt = <1050000>;
                    regulator-max-microvolt = <1050000>;
                };

                ldo6 {
                    regulator-name = "cam_vio";
                    regulator-min-microvolt = <1800000>;
                    regulator-max-microvolt = <1800000>;
                };

                ldo13 {
                    regulator-name = "cam_vana";
                    regulator-min-microvolt = <2800000>;
                    regulator-max-microvolt = <2800000>;
                };
            };

            leds {
                #address-cells = <1>;
                #size-cells = <0>;

                led@0 {
                    reg = <0>;
                    color = <LED_COLOR_ID_WHITE>;
                    function = LED_FUNCTION_FLASH;
                    led-max-microamp = <300000>;
                    flash-max-microamp = <1200000>;
                    flash-max-timeout-us = <500000>;
                };
            };
        };
    };

...
```

## Documentation/devicetree/bindings/mfd/samsung,s2mpb03.yaml
```yaml
# SPDX-License-Identifier: (GPL-2.0 OR BSD-2-Clause)
%YAML 1.2
---
$id: http://devicetree.org/schemas/mfd/samsung,s2mpb03.yaml#
$schema: http://devicetree.org/meta-schemas/core.yaml#

title: Samsung S2MPB03 Power Management IC

maintainers:
  - William Floyd <git@notmy.space>

description:
  The S2MPB03 is a companion power management IC for the camera sensors in
  smart phones, providing seven LDO regulators. It is typically reached over
  a dedicated I2C bus rather than the main PMIC bus.

properties:
  compatible:
    const: samsung,s2mpb03

  reg:
    maxItems: 1

  regulators:
    type: object
    patternProperties:
      "^ldo[1-7]$":
        type: object
        $ref: /schemas/regulator/regulator.yaml#
        unevaluatedProperties: false

        required:
          - regulator-name

    additionalProperties: false

required:
  - compatible
  - reg
  - regulators

additionalProperties: false

examples:
  - |
    i2c {
        #address-cells = <1>;
        #size-cells = <0>;

        pmic@56 {
            compatible = "samsung,s2mpb03";
            reg = <0x56>;

            regulators {
                ldo1 {
                    regulator-name = "cam_vdig";
                    regulator-min-microvolt = <1000000>;
                    regulator-max-microvolt = <1000000>;
                };

                ldo3 {
                    regulator-name = "cam_vio";
                    regulator-min-microvolt = <1800000>;
                    regulator-max-microvolt = <1800000>;
                };

                ldo5 {
                    regulator-name = "cam_vana";
                    regulator-min-microvolt = <3200000>;
                    regulator-max-microvolt = <3200000>;
                };
            };
        };
    };

...
```

## Documentation/devicetree/bindings/mmc/telechips,tcc803x-sdhci.yaml
```yaml
# SPDX-License-Identifier: (GPL-2.0-only OR BSD-2-Clause)
%YAML 1.2
---
$id: http://devicetree.org/schemas/mmc/telechips,tcc803x-sdhci.yaml#
$schema: http://devicetree.org/meta-schemas/core.yaml#

title: Telechips TCC803x SD/MMC Host Controller

maintainers:
  - William Floyd <git@notmy.space>

description: |
  Telechips TCC803x SoCs integrate three SD/eMMC host controller
  instances (SDHC0..SDHC2) built around a standard SDHCI core: the
  vendor 3.18 driver (drivers/mmc/host/sdhci-tcc.c in the
  AVNT5W_TCC803XKK_kernel vendor tree) is a platform glue driver
  depending on MMC_SDHCI_PLTFM and operating on a struct sdhci_host,
  not a from-scratch register interface. Each controller additionally
  exposes a second, SoC-wide "channel control" register region shared
  across all three instances (clock divider/gating and RX/TX tap delay
  tuning registers for all channels, including a single shared
  auto-tune-result register at a fixed offset read back by every
  instance), plus an optional third "channel mux" region that the
  vendor devicetree leaves unpopulated (zero address/size) on this
  board. This shared-region layout is why a new, vendor-specific
  binding is used instead of a single-region generic SDHCI binding.

allOf:
  - $ref: mmc-controller.yaml#

properties:
  compatible:
    const: telechips,tcc803x-sdhci

  reg:
    description: |
      Four regions, in this order:
        1. The per-instance SDHCI core register set.
        2. This instance's slice (a per-channel offset) of the SoC-wide
           channel-control block (clock div/gating and TX/RX tap-delay
           tuning registers for all three channels).
        3. The channel-mux region. Unpopulated (0x0 0x0) on known
           vendor boards.
        4. The auto-tune-result register (4 bytes). Also at an
           identical physical address on all three sdhc nodes -- one
           shared status register read by every instance, indexed
           internally by the driver using "controller-id".
    minItems: 4
    maxItems: 4

  interrupts:
    maxItems: 1

  clocks:
    items:
      - description: SDHC core/bit-rate clock
      - description: SDHC AHB/IO bus clock

  clock-names:
    items:
      - const: mmc_fclk
      - const: mmc_hclk

  telechips,controller-id:
    $ref: /schemas/types.yaml#/definitions/uint32
    description:
      Index of this SDHC instance (0, 1 or 2), used by the vendor
      driver to select this channel's slice of the shared
      channel-control and auto-tune-result registers described above.
    minimum: 0
    maximum: 2

  reset-gpios:
    maxItems: 1
    description:
      eMMC hardware reset line, if wired. Vendor equivalent is the
      bespoke "tcc-mmc-reset" property (e.g. vendor mobis/tcc8031-
      android-avn.dtsi:803, &gpsd0 14 0); this binding uses the
      standard reset-gpios name instead. Optional -- the AVN eMMC
      enables cap-mmc-hw-reset without this property today because no
      GPIO controller/pinctrl driver exists yet for this board; the
      driver treats an absent reset-gpios as a no-op, matching the
      vendor driver's own gpio_is_valid() guard.

  telechips,clk-out-tap:
    $ref: /schemas/types.yaml#/definitions/uint32
    description:
      Output clock tap-delay override for this channel's TAPDLY
      register. Mainline-named equivalent of the vendor's
      "tcc-mmc-clk-out-tap" (sdhci-tcc.c sdhci_tcc_parse_channel_configs).
      Driver default (also the vendor default) is 8 when unspecified.

  telechips,cmd-tap:
    $ref: /schemas/types.yaml#/definitions/uint32
    description:
      Command line tap-delay override for this channel's DELAY_CON0
      register. Mainline-named equivalent of the vendor's
      "tcc-mmc-cmd-tap". Driver default (also the vendor default) is
      7 when unspecified.

  telechips,data-tap:
    $ref: /schemas/types.yaml#/definitions/uint32
    description:
      Data line tap-delay override for this channel's DELAY_CON1-4
      registers. Mainline-named equivalent of the vendor's
      "tcc-mmc-data-tap". Driver default (also the vendor default) is
      7 when unspecified.

required:
  - compatible
  - reg
  - interrupts
  - clocks
  - clock-names

unevaluatedProperties: false

examples:
  - |
    #include <dt-bindings/interrupt-controller/arm-gic.h>
    mmc@16440000 {
      compatible = "telechips,tcc803x-sdhci";
      reg = <0x16440000 0x100>, <0x16470000 0x200>,
            <0x0 0x0>, <0x164700fc 0x4>;
      interrupts = <GIC_SPI 74 IRQ_TYPE_LEVEL_HIGH>;
      clocks = <&ckc 0>, <&ckc 1>;
      clock-names = "mmc_fclk", "mmc_hclk";
      telechips,controller-id = <0>;
      bus-width = <8>;
      non-removable;
    };
```

## Documentation/devicetree/bindings/nvmem/telechips,tcc803x-otp.yaml
```yaml
# SPDX-License-Identifier: (GPL-2.0-only OR BSD-2-Clause)
%YAML 1.2
---
$id: http://devicetree.org/schemas/nvmem/telechips,tcc803x-otp.yaml#
$schema: http://devicetree.org/meta-schemas/core.yaml#

title: Telechips TCC803x OTP fuses behind the secure monitor

maintainers:
  - William Floyd <git@notmy.space>

description: |
  The one-time-programmable fuses hold secure-boot keys, chip configuration
  and the boot-width state. On TCC803x the OTP controller is secure I/O
  (OP-TEE maps it MEM_AREA_IO_SEC) and the vendor firmware reaches it only
  through the monitor, so the node carries no registers; the driver reads it
  with a SiP SMC. Exposed read-only.

allOf:
  - $ref: nvmem.yaml#
  - $ref: nvmem-deprecated-cells.yaml#

properties:
  compatible:
    const: telechips,tcc803x-otp

required:
  - compatible

unevaluatedProperties: false

examples:
  - |
    otp {
        compatible = "telechips,tcc803x-otp";
        #address-cells = <1>;
        #size-cells = <1>;

        boot-width@2 {
            reg = <0x2 0x1>;
        };
    };

...
```

## Documentation/devicetree/bindings/phy/telechips,tcc803x-usb-otg-phy.yaml
```yaml
# SPDX-License-Identifier: (GPL-2.0-only OR BSD-2-Clause)
%YAML 1.2
---
$id: http://devicetree.org/schemas/phy/telechips,tcc803x-usb-otg-phy.yaml#
$schema: http://devicetree.org/meta-schemas/core.yaml#

title: Telechips TCC803x USB OTG PHY

maintainers:
  - William Floyd <git@notmy.space>

description: |
  The HS PHY behind the DWC2 OTG core (vendor dwc_otg_phy@11DA0100). A mux in
  its register block (OTGMUX) hands the PHY pins either to the OTG core or to
  the EHCI/OHCI pair at 0x11900000; the driver selects the OTG core, so the
  EHCI/OHCI mux pair must stay disabled while this PHY is in use. The HSIO bus
  and ISOIP clocks are left as the firmware set them.

properties:
  compatible:
    const: telechips,tcc803x-dwc-otg-phy

  reg:
    maxItems: 1

  "#phy-cells":
    const: 0

  vbus-gpios:
    maxItems: 1
    description:
      Port VBUS supply enable. Driven inactive for as long as the PHY is bound,
      as this PHY is only used in peripheral mode, where the host supplies VBUS.

required:
  - compatible
  - reg
  - "#phy-cells"

additionalProperties: false

examples:
  - |
    phy@11da0100 {
        compatible = "telechips,tcc803x-dwc-otg-phy";
        reg = <0x11da0100 0x30>;
        #phy-cells = <0>;
    };
```
