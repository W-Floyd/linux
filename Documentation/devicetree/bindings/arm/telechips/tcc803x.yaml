## Documentation/devicetree/bindings/media/qcom,sm6225-camss.yaml
```yaml
# SPDX-License-Identifier: (GPL-2.0 OR BSD-2-Clause)
%YAML 1.2
---
$id: http://devicetree.org/schemas/media/qcom,sm6225-camss.yaml#
$schema: http://devicetree.org/meta-schemas/core.yaml#

title: Qualcomm SM6225 Camera Subsystem (CAMSS)

maintainers:
  - Loic Poulain <loic.poulain@oss.qualcomm.com>

description:
  The CAMSS IP is a CSI decoder and ISP present on Qualcomm platforms.

  SM6225 carries the same TFE-based CSID and VFE as QCM2290, widened to three
  pipes, in front of a CSIPHY of the revision SM8250 uses -- which is laid out
  on a 0x2000 register stride rather than QCM2290's 0x1000. It has no test
  pattern generator block.

properties:
  compatible:
    const: qcom,sm6225-camss

  reg:
    maxItems: 10

  reg-names:
    items:
      - const: top
      - const: csid0
      - const: csid1
      - const: csid2
      - const: csiphy0
      - const: csiphy1
      - const: csiphy2
      - const: vfe0
      - const: vfe1
      - const: vfe2

  clocks:
    maxItems: 20

  clock-names:
    items:
      - const: ahb
      - const: axi
      - const: camnoc_nrt_axi
      - const: camnoc_rt_axi
      - const: csi0
      - const: csi1
      - const: csi2
      - const: csiphy0
      - const: csiphy0_timer
      - const: csiphy1
      - const: csiphy1_timer
      - const: csiphy2
      - const: csiphy2_timer
      - const: top_ahb
      - const: vfe0
      - const: vfe0_cphy_rx
      - const: vfe1
      - const: vfe1_cphy_rx
      - const: vfe2
      - const: vfe2_cphy_rx

  interrupts:
    maxItems: 9

  interrupt-names:
    items:
      - const: csid0
      - const: csid1
      - const: csid2
      - const: csiphy0
      - const: csiphy1
      - const: csiphy2
      - const: vfe0
      - const: vfe1
      - const: vfe2

  interconnects:
    maxItems: 3

  interconnect-names:
    items:
      - const: ahb
      - const: hf_mnoc
      - const: sf_mnoc

  iommus:
    oneOf:
      - items:
          - description: S1 HLOS VFE non-protected (VFE only)
      - items:
          - description: S1 HLOS VFE non-protected
          - description: S1 HLOS CDM non-protected
          - description: S1 HLOS OPE read non-protected
          - description: S1 HLOS OPE write non-protected

  power-domains:
    items:
      - description: GDSC CAMSS Block, Global Distributed Switch Controller.

  vdd-csiphy-0p9-supply:
    description:
      Phandle to a 0.9V regulator supply to CSI PHYs.

  vdd-csiphy-1p2-supply:
    description:
      Phandle to a 1.2V regulator supply to CSI PHYs.

  ports:
    $ref: /schemas/graph.yaml#/properties/ports

    description:
      CSI input ports.

    patternProperties:
      "^port@[0-3]+$":
        $ref: /schemas/graph.yaml#/$defs/port-base
        unevaluatedProperties: false

        description:
          Input port for receiving CSI data from a CSIPHY.

        properties:
          endpoint:
            $ref: video-interfaces.yaml#
            unevaluatedProperties: false

            properties:
              data-lanes:
                minItems: 1
                maxItems: 4

            required:
              - data-lanes

required:
  - compatible
  - reg
  - reg-names
  - clocks
  - clock-names
  - interrupts
  - interrupt-names
  - interconnects
  - interconnect-names
  - iommus
  - power-domains
  - vdd-csiphy-0p9-supply
  - vdd-csiphy-1p2-supply

additionalProperties: false

examples:
  - |
    #include <dt-bindings/clock/qcom,gcc-sm6225.h>
    #include <dt-bindings/interconnect/qcom,rpm-icc.h>
    #include <dt-bindings/interconnect/qcom,sm6115.h>
    #include <dt-bindings/interrupt-controller/arm-gic.h>

    soc {
        #address-cells = <2>;
        #size-cells = <2>;

        camss: camss@5c11000 {
            compatible = "qcom,sm6225-camss";

            reg = <0x0 0x5c11000 0x0 0x1000>,
                  <0x0 0x5c6e000 0x0 0x1000>,
                  <0x0 0x5c75000 0x0 0x1000>,
                  <0x0 0x5c7c000 0x0 0x1000>,
                  <0x0 0x5c52000 0x0 0x2000>,
                  <0x0 0x5c54000 0x0 0x2000>,
                  <0x0 0x5c56000 0x0 0x2000>,
                  <0x0 0x5c6f000 0x0 0x4000>,
                  <0x0 0x5c76000 0x0 0x4000>,
                  <0x0 0x5c7d000 0x0 0x4000>;
            reg-names = "top",
                        "csid0",
                        "csid1",
                        "csid2",
                        "csiphy0",
                        "csiphy1",
                        "csiphy2",
                        "vfe0",
                        "vfe1",
                        "vfe2";

            clocks = <&gcc GCC_CAMERA_AHB_CLK>,
                     <&gcc GCC_CAMSS_AXI_CLK>,
                     <&gcc GCC_CAMSS_NRT_AXI_CLK>,
                     <&gcc GCC_CAMSS_RT_AXI_CLK>,
                     <&gcc GCC_CAMSS_TFE_0_CSID_CLK>,
                     <&gcc GCC_CAMSS_TFE_1_CSID_CLK>,
                     <&gcc GCC_CAMSS_TFE_2_CSID_CLK>,
                     <&gcc GCC_CAMSS_CPHY_0_CLK>,
                     <&gcc GCC_CAMSS_CSI0PHYTIMER_CLK>,
                     <&gcc GCC_CAMSS_CPHY_1_CLK>,
                     <&gcc GCC_CAMSS_CSI1PHYTIMER_CLK>,
                     <&gcc GCC_CAMSS_CPHY_2_CLK>,
                     <&gcc GCC_CAMSS_CSI2PHYTIMER_CLK>,
                     <&gcc GCC_CAMSS_TOP_AHB_CLK>,
                     <&gcc GCC_CAMSS_TFE_0_CLK>,
                     <&gcc GCC_CAMSS_TFE_0_CPHY_RX_CLK>,
                     <&gcc GCC_CAMSS_TFE_1_CLK>,
                     <&gcc GCC_CAMSS_TFE_1_CPHY_RX_CLK>,
                     <&gcc GCC_CAMSS_TFE_2_CLK>,
                     <&gcc GCC_CAMSS_TFE_2_CPHY_RX_CLK>;
            clock-names = "ahb",
                          "axi",
                          "camnoc_nrt_axi",
                          "camnoc_rt_axi",
                          "csi0",
                          "csi1",
                          "csi2",
                          "csiphy0",
                          "csiphy0_timer",
                          "csiphy1",
                          "csiphy1_timer",
                          "csiphy2",
                          "csiphy2_timer",
                          "top_ahb",
                          "vfe0",
                          "vfe0_cphy_rx",
                          "vfe1",
                          "vfe1_cphy_rx",
                          "vfe2",
                          "vfe2_cphy_rx";

            interrupts = <GIC_SPI 210 IRQ_TYPE_EDGE_RISING>,
                         <GIC_SPI 212 IRQ_TYPE_EDGE_RISING>,
                         <GIC_SPI 77 IRQ_TYPE_EDGE_RISING>,
                         <GIC_SPI 72 IRQ_TYPE_EDGE_RISING>,
                         <GIC_SPI 73 IRQ_TYPE_EDGE_RISING>,
                         <GIC_SPI 74 IRQ_TYPE_EDGE_RISING>,
                         <GIC_SPI 211 IRQ_TYPE_EDGE_RISING>,
                         <GIC_SPI 213 IRQ_TYPE_EDGE_RISING>,
                         <GIC_SPI 78 IRQ_TYPE_EDGE_RISING>;
            interrupt-names = "csid0",
                              "csid1",
                              "csid2",
                              "csiphy0",
                              "csiphy1",
                              "csiphy2",
                              "vfe0",
                              "vfe1",
                              "vfe2";

            interconnects = <&bimc MASTER_AMPSS_M0 RPM_ACTIVE_TAG
                             &config_noc SLAVE_CAMERA_CFG RPM_ACTIVE_TAG>,
                            <&mmrt_virt MASTER_CAMNOC_HF RPM_ALWAYS_TAG
                             &bimc SLAVE_EBI_CH0 RPM_ALWAYS_TAG>,
                            <&mmnrt_virt MASTER_CAMNOC_SF RPM_ALWAYS_TAG
                             &bimc SLAVE_EBI_CH0 RPM_ALWAYS_TAG>;
            interconnect-names = "ahb",
                                 "hf_mnoc",
                                 "sf_mnoc";

            iommus = <&apps_smmu 0x400 0x0>,
                     <&apps_smmu 0x800 0x0>,
                     <&apps_smmu 0x820 0x0>,
                     <&apps_smmu 0x840 0x0>;

            power-domains = <&gcc GCC_CAMSS_TOP_GDSC>;

            vdd-csiphy-0p9-supply = <&vreg_l4a>;
            vdd-csiphy-1p2-supply = <&vreg_l18a>;

            ports {
                #address-cells = <1>;
                #size-cells = <0>;
            };
        };
    };
```

## Documentation/devicetree/bindings/media/telechips,tcc803x-vioc-rearview.yaml
```yaml
# SPDX-License-Identifier: (GPL-2.0-only OR BSD-2-Clause)
%YAML 1.2
---
$id: http://devicetree.org/schemas/media/telechips,tcc803x-vioc-rearview.yaml#
$schema: http://devicetree.org/meta-schemas/core.yaml#

title: Telechips TCC803x VIOC rear-view camera path

maintainers:
  - William Floyd <git@notmy.space>

description:
  The VIOC blocks that capture a camera decoder (VIN, simple deinterlacer,
  scaler, WMIX, WDMA) and the RDMA and async FIFO that feed the frames to
  image 1 of the display WMIX0. The camera is shown over the UI by raising
  that image's overlay priority. Block choice follows the vendor's board
  configuration (VIN0, SC2, WMIX5, WDMA5, RDMA1).

properties:
  compatible:
    const: telechips,tcc803x-vioc-rearview

  reg:
    items:
      - description: VIN
      - description: DEINTL_S simple deinterlacer
      - description: scaler
      - description: capture WMIX
      - description: WDMA
      - description: display RDMA (an input of the display WMIX)
      - description: async FIFO
      - description: DDI_CONFIG CIFPORT0, VIN input-port select

  reg-names:
    items:
      - const: vin
      - const: deintls
      - const: scaler
      - const: wmix
      - const: wdma
      - const: rdma
      - const: fifo
      - const: cifport

  clocks:
    maxItems: 1

  clock-names:
    const: ddi

  telechips,vioc-config:
    $ref: /schemas/types.yaml#/definitions/phandle
    description: VIOC config block (path select, software resets).

  telechips,display:
    $ref: /schemas/types.yaml#/definitions/phandle
    description:
      The display CRTC node, whose "wmix" and "disp" register windows are
      shared with this device.

  gear-gpios:
    description: Reverse-gear input; the camera is shown while it is active.
    maxItems: 1

  port:
    $ref: /schemas/graph.yaml#/properties/port
    description: Input from the camera decoder.

required:
  - compatible
  - reg
  - reg-names
  - telechips,vioc-config
  - telechips,display
  - port

additionalProperties: false

examples:
  - |
    #include <dt-bindings/gpio/gpio.h>

    rearview@12004000 {
        compatible = "telechips,tcc803x-vioc-rearview";
        reg = <0x12004000 0x100>, <0x12003800 0x100>, <0x12002200 0x100>,
              <0x12001d00 0x100>, <0x12002d00 0x100>, <0x12000500 0x100>,
              <0x12003b00 0x100>, <0x12380008 0x4>;
        reg-names = "vin", "deintls", "scaler", "wmix", "wdma", "rdma",
                    "fifo", "cifport";
        telechips,vioc-config = <&vioc_config>;
        telechips,display = <&vioc_crtc0>;
        gear-gpios = <&pinctrl 31 GPIO_ACTIVE_HIGH>;

        port {
            rearview_in: endpoint {
                remote-endpoint = <&tw9990_out>;
            };
        };
    };
```

## Documentation/devicetree/bindings/media/telechips,tcc803x-wave410.yaml
```yaml
# SPDX-License-Identifier: (GPL-2.0-only OR BSD-2-Clause)
%YAML 1.2
---
$id: http://devicetree.org/schemas/media/telechips,tcc803x-wave410.yaml#
$schema: http://devicetree.org/meta-schemas/core.yaml#

title: Chips&Media Wave410 HEVC decoder in the Telechips TCC803x

maintainers:
  - William Floyd <git@notmy.space>

description:
  A Chips&Media Wave4 series HEVC (Main profile) decoder with its own VCPU
  firmware, next to the CODA960 on the TCC803x video bus. Its bus and core
  clocks are video-bus gates owned by the secure monitor.

properties:
  compatible:
    const: telechips,tcc803x-wave410

  reg:
    maxItems: 1

  interrupts:
    maxItems: 1

  clocks:
    items:
      - description: HEVC core video-bus gate
      - description: HEVC bus video-bus gate

  clock-names:
    items:
      - const: core
      - const: bus

  resets:
    maxItems: 1

required:
  - compatible
  - reg
  - interrupts
  - clocks
  - clock-names
  - resets

additionalProperties: false

examples:
  - |
    #include <dt-bindings/clock/telechips,tcc803x-clks.h>
    #include <dt-bindings/interrupt-controller/arm-gic.h>

    video-codec@15200000 {
        compatible = "telechips,tcc803x-wave410";
        reg = <0x15200000 0xa000>;
        interrupts = <GIC_SPI 136 IRQ_TYPE_LEVEL_HIGH>;
        clocks = <&sipclk TCC803X_SIPCLK_VPUBUS_HEVC_CORE>,
                 <&sipclk TCC803X_SIPCLK_VPUBUS_HEVC_BUS>;
        clock-names = "core", "bus";
        resets = <&sipclk TCC803X_SIPRST_HEVC>;
    };
```
