## Documentation/devicetree/bindings/display/telechips/telechips,tcc803x-lvds.yaml
```yaml
# SPDX-License-Identifier: (GPL-2.0-only OR BSD-2-Clause)
%YAML 1.2
---
$id: http://devicetree.org/schemas/display/telechips/telechips,tcc803x-lvds.yaml#
$schema: http://devicetree.org/meta-schemas/core.yaml#

title: Telechips TCC803x on-die LVDS PHY/serializer

maintainers:
  - William Floyd <git@notmy.space>

description: |
  The TCC803x on-die LVDS transmitter (PHY + serializer), distinct from
  the VIOC MISCCFG MRGB mux in telechips,tcc803x-mrgb-panel.yaml.

  reg and the PERI_LVDS_PHY clock (ID 105) are from the vendor kernel
  (AVNT5W_TCC803XKK_kernel tcc803x.dtsi, lvds_phy@12370000, GPLv2). The
  vendor LK bootloader (platform/tcc803x/vioc/lvds_phy.c, GPLv2) names the
  regions: on system_rev == 0 its PHY ports are HwVIOC_BASE + 0x370000 /
  0x360000 + (port << 10), i.e. single port S0 = 0x12370000, S1 =
  0x12370400 (unused by the vendor), dual ports D0 = 0x12360800 and D1 =
  0x12360c00. On system_rev != 0 it uses 0x1b941000 / 0x1b942800 /
  0x1b942c00 instead, plus an LVDS wrapper at 0x1b940000 this binding does
  not describe.

  Unresolved: a live read on a displaying unit found all 4 regions reading
  0x00000000, while the vendor init leaves RESETB (offset 0) at 0x1fff.
  Three explanations, not distinguished yet: this unit is a system_rev != 0
  part and the PHY lives at the 0x1b94xxxx addresses instead; the read was
  wrong; or this product's actual display path doesn't use this PHY at all
  (one vendor LK build target for this product compiles an HDMI->ADV7613
  path instead and excludes the LVDS panel code entirely, which would leave
  RESETB at its unprogrammed reset value of 0 for an unrelated reason). A
  live clock-gate read on this unit found the LVDS PHY's own clock enabled,
  which argues against the third explanation but doesn't rule it out (a
  gate can be left on for other reasons). system_rev is read with the
  read-only SMC SIP_CHIP_REV (SIP_CMD(7,0) = 0x82007000); source alone
  can't give its value on this unit -- check cat /proc/chipinfo or the
  stock boot log. Check before setting telechips,phy-init.

  The telechips,phy-init properties below drive the vendor's init sequence.
  Without telechips,phy-init the PHY is left as the bootloader set it.

properties:
  compatible:
    const: telechips,tcc803x-lvds

  reg:
    items:
      - description: LVDS PHY/serializer region 0 (0x12370000)
      - description: LVDS PHY/serializer region 1 (0x12370400)
      - description: LVDS config region 0 (0x12360800)
      - description: LVDS config region 1 (0x12360c00)

  reg-names:
    items:
      - const: lvds0
      - const: lvds1
      - const: lvds-cfg0
      - const: lvds-cfg1

  clocks:
    maxItems: 1
    description: PERI_LVDS_PHY (CKC_PCLKCTRL channel 105)

  clock-names:
    items:
      - const: lvds-phy

  port:
    $ref: /schemas/graph.yaml#/properties/port
    description:
      Input endpoint, paired with the upstream CRTC's own output
      endpoint the same way hdmi_tx's "port" is in tcc803x.dtsi --
      devm_drm_of_get_bridge(dev, dev->of_node, 0, 0) on the CRTC side
      resolves exactly one such endpoint. hdmi_tx and this node cannot
      both be the live target of that single endpoint at once; which
      one is wired is a board-DT-time choice (see tcc803x-avn.dts).

  telechips,phy-init:
    type: boolean
    description:
      Program the PHY on enable instead of keeping the bootloader's setup.

  telechips,vcm-millivolt:
    $ref: /schemas/types.yaml#/definitions/uint32
    description:
      Panel's typical LVDS common-mode voltage. Panel-specific, no default.
    minimum: 0
    maximum: 2000

  telechips,vsw-millivolt:
    $ref: /schemas/types.yaml#/definitions/uint32
    description:
      Panel's typical LVDS differential swing. Panel-specific, no default.
    minimum: 0
    maximum: 1000

  telechips,dual-link:
    type: boolean
    description:
      Drive dual ports D0 (primary, lvds-cfg0) and D1 (secondary,
      lvds-cfg1), one pixel each per clock. Absent, single port S0 (lvds0).

  telechips,data-mapping:
    $ref: /schemas/types.yaml#/definitions/string
    enum: [vesa-24, jeida-24, jeida-18]
    default: vesa-24

  telechips,lane-select:
    $ref: /schemas/types.yaml#/definitions/uint32-array
    description:
      PHY input feeding each output lane (CLK, DATA0..3) of the primary
      port, as 0 = CLK, 1..4 = DATA0..3. Board routing; defaults to
      identity.
    minItems: 5
    maxItems: 5
    items:
      maximum: 4

  telechips,secondary-lane-select:
    $ref: /schemas/types.yaml#/definitions/uint32-array
    description: As telechips,lane-select, for the secondary port.
    minItems: 5
    maxItems: 5
    items:
      maximum: 4

required:
  - compatible
  - reg
  - reg-names
  - clocks
  - clock-names

dependentRequired:
  telechips,phy-init: [telechips,vcm-millivolt, telechips,vsw-millivolt]
  telechips,secondary-lane-select: [telechips,dual-link]

additionalProperties: false

examples:
  - |
    lvds-phy@12370000 {
        compatible = "telechips,tcc803x-lvds";
        reg = <0x12370000 0x400>, <0x12370400 0x400>,
              <0x12360800 0x400>, <0x12360c00 0x400>;
        reg-names = "lvds0", "lvds1", "lvds-cfg0", "lvds-cfg1";
        clocks = <&ckc 105>;
        clock-names = "lvds-phy";

        port {
            lvds_phy_in: endpoint {
                remote-endpoint = <&vioc_crtc0_out>;
            };
        };
    };

...
```

## Documentation/devicetree/bindings/display/telechips/telechips,tcc803x-mrgb-panel.yaml
```yaml
# SPDX-License-Identifier: (GPL-2.0-only OR BSD-2-Clause)
%YAML 1.2
---
$id: http://devicetree.org/schemas/display/telechips/telechips,tcc803x-mrgb-panel.yaml#
$schema: http://devicetree.org/meta-schemas/core.yaml#

title: Telechips TCC803x VIOC MRGB (synchronous parallel-RGB) panel output

maintainers:
  - William Floyd <git@notmy.space>

description: |
  A panel driven directly off a VIOC DISP timing generator through the
  OUTCFG MISCCFG.MRGBSEL mux documented in
  telechips,tcc803x-output-config.yaml (selector value VIOC_OUTCFG_MRGB
  = 4, include/video/tcc/vioc_outcfg.h:37,
  AVNT5W_TCC803XKK_kernel). MRGBSEL only selects *which* DISP feeds the
  MRGB output pins; it carries no format/timing configuration of its
  own, and no other MRGB-specific register block exists anywhere in the
  extracted vendor source (struct VIOC_OUTCFG, vioc_outcfg.h:81-86, is
  4 x 32-bit words total: D0CPUIF/D1CPUIF/D2CPUIF/MISCCFG, nothing
  named mrgb/MRGB beyond that). DISP0 itself generates the entire pixel
  stream (timing generator, sync, pixel-clock divider) -- this output
  type is structurally a thin, passive mux selection, not a separate
  display controller.

  Not MIPI DSI: the comment "// MIPI RGB OUTPUT" next to the MRGBSEL
  bitfield in vioc_outcfg.h:71 (mirrored by "// MIPI I80 OUTPUT" on the
  adjacent M80SEL field at vioc_outcfg.h:69) does not mean this is a
  MIPI Alliance DSI/DBI serial link. The same vendor tree separately
  defines a real, distinct MIPI DSI output type:
    - enum TCC_DB_OUT_{RGB,LVDS,DSI,HDMI} (include/video/tcc/tcc_fb.h:
      74-79, arch/arm/mach-tcc803x/include/mach/tcc_fb.h:74-79) --
      TCC_DB_OUT_RGB and TCC_DB_OUT_DSI are sibling, independent
      values, not variants of one path.
    - drivers/video/fbdev/tcc-fb/tcc_mipi_dsi.c, a CONFIG_TCC_MIPI-
      gated driver with its own "dsib" clock (tcc_mipi_dsi.c:70,
      clk_get(0, "dsib"), currently #if 0'd out in that file) --
      entirely separate code/clock from vioc_outcfg/MRGBSEL.
    - TCC_DB_OUT_RGB's own dispatch is an empty no-op
      (drivers/video/fbdev/tcc-fb/tcc_displayblock.c:20-21,
      `case TCC_DB_OUT_RGB: break;` installs no ops struct at all),
      unlike TCC_DB_OUT_DSI which installs &tcc_db_dsi_ops
      (tcc_displayblock.c:26-28) -- consistent with RGB/MRGB needing no
      protocol-level driver beyond DISP0's own timing generator plus
      the OUTCFG mux bit.
  Reading "MIPI" in the MISCCFG comments as Telechips' datasheet name
  for the physical CPU-interface *pin group* shared by the M80
  (8080-style MCU) and MRGB (synchronous RGB) output formatters is the
  interpretation this binding assumes; no TCC803x MIPI D-PHY/DSI
  hardware block is involved in the MRGB path.

  IMPORTANT CAVEAT: VIOC_OUTCFG_MRGB (selector value 4) is never passed
  to VIOC_OUTCFG_SetOutConfig() by any board file, platform driver, or
  panel driver anywhere in the extracted AVNT5W_TCC803XKK_kernel tree --
  every call site found greps to VIOC_OUTCFG_HDMI/_SDVENC/_HDVENC only
  (arch/arm/mach-tcc803x/vioc/vioc_outcfg.c and
  drivers/video/fbdev/tcc-fb/vioc/vioc_outcfg.c define the MRGB case,
  but nothing calls it with that argument). The only other board in
  this same vendor tree with a comparable 1920x720 panel (tianma
  TM123XDHP90, drivers/video/fbdev/tcc-fb/lcd_TM123XDHP90.c,
  "telechips,lvds-tm123xdhp90") is LVDS-driven off DISP0, same as this
  node -- not DISP1 as an earlier pass here claimed. That board file,
  arch/arm/boot/dts/tcc/tcc8030-android-lpd4321_sv0.1.dts:138-152, is
  not an unrelated cousin: it `#include`s the real AVN board's own
  base dtsi, arch/arm/boot/dts/mobis/tcc8031-android-avn.dtsi,
  unmodified, and carries zero DISP overrides of its own. That shared
  base dtsi's `fbdisplay@12000000` node sets `telechips,fbdisplay_num =
  <0>`, read directly as the DISP controller index by every consumer
  driver checked (drivers/video/fbdev/tcc-fb/tcc_vioc_fb.c:2526,
  drivers/gpu/drm/tcc/tcc_drm_lcd.c:787) -- DISP0 either way. So the
  real, vendor-confirmed-working LVDS precedent is a same-DISP,
  same-board-family alternative output type for a same-resolution
  panel, not merely a structural curiosity. The TCC803x SoC also has
  genuine on-die LVDS transmitter hardware (`lvds_phy@12370000`,
  clocked by `PERI_LVDS_PHY`, tcc803x.dtsi:2266-2271) -- LVDS off this
  chip needs no external bridge. The real AVN board's own
  `mobis-gpio-pinctrl` node additionally names
  `lvds_variant_check-gpio` and `digital_variant_check-gpio` side by
  side (tcc8031-android-avn.dtsi:~890), implying this board ships (or
  shipped) in two real panel-interface variants, detected/selected at
  board level -- LVDS, and a "digital" variant more plausibly read as
  DISP0's native parallel-RGB pins driven directly (bypassing MISCCFG
  entirely) than as this binding's MISCCFG-routed MRGB path, which has
  no consumer anywhere in the vendor tree. This node's routing is
  grounded instead in a live MISCCFG register read off the real
  running head unit (outside this static-source investigation) showing
  MRGBSEL selecting DISP0; static vendor source alone does not
  independently corroborate that selection, and MRGBSEL=0 is equally
  consistent with that field simply never having been touched since
  reset -- LVDS does not route through MISCCFG at all, so that reading
  carries no evidence either way between LVDS and MRGB. Net
  assessment: LVDS off DISP0 is better supported by vendor source
  (working driver, on-die PHY, explicit board-level variant-detection
  GPIOs) than MRGB off DISP0 (zero consumers anywhere); this binding
  is retained as honest scaffolding for the live-register-backed
  hypothesis, not as the higher-confidence conclusion. Resolving this
  for the specific unit needs either a live read of
  lvds_variant_check-gpio / digital_variant_check-gpio, or confirming
  whether DISP0's pixel stream reaches the panel through lvds_phy.

  Timing values below are not estimated: they are the same live DISP0
  register capture (LHTIME1/2, LVTIME1/2) already used to program the
  CRTC in drivers/gpu/drm/telechips/tcc803x_drm_vioc.c, decoded through
  that file's DISP_LHTIME1/2 and DISP_LVTIME1/2 bitfield layout. They
  describe DISP0's own timing generator, which this output path merely
  passes through unmodified -- not an MRGB-specific register.
  clock-frequency is deliberately left unlisted among this binding's
  properties (and absent from its DT instance): the real pixel-clock
  rate is the same open PLL/clock-source question tcc803x_drm_vioc.c's
  atomic_enable() comment already tracks (live LCLKDIV reads
  PXCLKDIV=0, ACDIV=0, which does not resolve cleanly against the
  divider formula in that driver's own citation of
  vioc_disp.h/tca_lcdc.c) -- supplying a number here would be a guess
  presented as fact. This is a known, separately-tracked gap, not an
  oversight.

properties:
  compatible:
    description:
      Placeholder compatible: the real panel's manufacturer and part
      number are not identified in any vendor source found so far (the
      touch-panel driver nodes in tcc8031-android-avn.dtsi give
      1920x720 touch coordinates and panel-coords, not a display-panel
      part number). Not "panel-dpi" -- that binding requires
      power-supply, which is equally unconfirmed, and this node would
      rather omit the property than guess a regulator.
    const: telechips,tcc803x-mrgb-panel

  width-mm:
    const: 92

  height-mm:
    const: 243

  port:
    $ref: /schemas/graph.yaml#/properties/port
    description:
      Not yet connected to anything: no driver walks this node's graph
      (or binds the vioc_crtc0/output_config nodes together) today.
      Present for schema completeness and for whichever future MRGB/
      CRTC driver wires the pipeline up for real.

  panel-timing:
    type: object
    description:
      Live-captured DISP0 hactive/vactive/porch/sync counts (see
      description above). A reduced property set compared to the
      generic panel-timing.yaml schema -- clock-frequency, which that
      schema requires, is intentionally not among the properties below.
    properties:
      hactive:
        const: 1920
      vactive:
        const: 720
      hsync-len:
        const: 31
      hfront-porch:
        const: 49
      hback-porch:
        const: 159
      vsync-len:
        const: 4
      vfront-porch:
        const: 14
      vback-porch:
        const: 27
    required:
      - hactive
      - vactive
      - hsync-len
      - hfront-porch
      - hback-porch
      - vsync-len
      - vfront-porch
      - vback-porch
    additionalProperties: false

required:
  - compatible
  - panel-timing

additionalProperties: false

examples:
  - |
    panel {
        compatible = "telechips,tcc803x-mrgb-panel";
        width-mm = <92>;
        height-mm = <243>;

        panel-timing {
            hactive = <1920>;
            vactive = <720>;
            hsync-len = <31>;
            hfront-porch = <49>;
            hback-porch = <159>;
            vsync-len = <4>;
            vfront-porch = <14>;
            vback-porch = <27>;
        };
    };

...
```
