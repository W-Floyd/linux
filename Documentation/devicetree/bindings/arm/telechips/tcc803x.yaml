## Documentation/devicetree/bindings/display/telechips/telechips,tcc803x-vioc-plane.yaml
```yaml
# SPDX-License-Identifier: (GPL-2.0-only OR BSD-2-Clause)
%YAML 1.2
---
$id: http://devicetree.org/schemas/display/telechips/telechips,tcc803x-vioc-plane.yaml#
$schema: http://devicetree.org/meta-schemas/core.yaml#

title: Telechips TCC803x VIOC RDMA (DRM plane)

maintainers:
  - William Floyd <git@notmy.space>

description: |
  One channel of the TCC803x VIOC's RDMA ("read-DMA") array: a memory-to-
  VIOC image fetcher that feeds one input layer of a WMIX mixer. The VIOC
  has 18 RDMA channels (vioc_rdma0..17); this binding describes a single
  channel's own 0x48-byte register window (control, size, base-address,
  offset, scale, alpha, status/irq-mask, 3D/sync bases, crop), not the
  whole array.

  Register layout confirmed against the real vendor Linux 3.18 tree
  (AVNT5W_TCC803XKK_kernel, Hyundai Mobis supplier-portal release,
  Telechips Inc., GPLv2):
    arch/arm/mach-tcc803x/include/mach/vioc_rdma.h:214-234 (register map,
      struct TYPEDEF_VIOC_RDMA)
    arch/arm/mach-tcc803x/vioc/vioc_rdma.c (bit-level access: CTRL.FMT
      bits[4:0], CTRL.UPD bit16, CTRL.IEN bit28; SIZE packs
      (height<<16)|width)
    arch/arm/boot/dts/mobis/tcc803x.dtsi:1994-1998 (RDMA0 base address
      0x12000400; channels 1..17 step by 0x100)
    include/dt-bindings/display/tcc803x-vioc.h:190 cites VIOC0_IRQI =
      119, but live recon on the real board contradicts it: the vendor's
      own tcc_vsync driver logs irq_num(151) at boot, and live
      /proc/interrupts shows GIC 151 ("TCC_MAIN_D") actively firing while
      GIC 119 is pl08xdmac (the DMA controller, unrelated). The shared
      VIOC bus-0 interrupt every RDMA/WMIX/DISP channel multiplexes onto
      is GIC SPI 151.

  Only RDMA0 (0x12000400) is described in the SoC .dtsi so far, enough
  for a single primary plane. The other 17 channels, and the companion
  WDMA (write-DMA / capture) and scaler (SC) blocks that share the same
  IRQ line and vioc-config IRQ-select registers, are not modeled yet.

  No IOMMU is known to sit in front of this RDMA channel (not confirmed
  either way for this VIOC generation), so the plane driver scans out
  directly from whatever physical address a GEM-DMA framebuffer lands
  at -- no "memory-region" carve-out is required or modeled here.

properties:
  compatible:
    const: telechips,tcc803x-vioc-plane

  reg:
    maxItems: 1

  interrupts:
    maxItems: 1
    description: |
      Shared VIOC bus-0 interrupt (VIOC0_IRQI = SPI 151). Every RDMA,
      WMIX, DISP and WDMA channel on this VIOC bus multiplexes onto the
      same GIC line; which channel actually raised it is read back from
      the shared vioc-config interrupt-status registers (not yet bound
      by this schema -- see telechips,tcc803x-vioc-config.yaml).

required:
  - compatible
  - reg
  - interrupts

additionalProperties: false

examples:
  - |
    #include <dt-bindings/interrupt-controller/arm-gic.h>
    vioc_rdma0: vioc-rdma@12000400 {
        compatible = "telechips,tcc803x-vioc-plane";
        reg = <0x12000400 0x48>;
        interrupts = <GIC_SPI 151 IRQ_TYPE_LEVEL_HIGH>;
    };
```

## Documentation/devicetree/bindings/i2c/telechips,tcc803x-i2c.yaml
```yaml
# SPDX-License-Identifier: (GPL-2.0-only OR BSD-2-Clause)
%YAML 1.2
---
$id: http://devicetree.org/schemas/i2c/telechips,tcc803x-i2c.yaml#
$schema: http://devicetree.org/meta-schemas/core.yaml#

title: Telechips TCC803x I2C master

maintainers:
  - William Floyd <git@notmy.space>

allOf:
  - $ref: /schemas/i2c/i2c-controller.yaml#

properties:
  compatible:
    const: telechips,tcc803x-i2c

  reg:
    maxItems: 1

required:
  - compatible
  - reg

unevaluatedProperties: false

examples:
  - |
    i2c@16310000 {
        compatible = "telechips,tcc803x-i2c";
        reg = <0x16310000 0x1c>;
        #address-cells = <1>;
        #size-cells = <0>;
    };
```

## Documentation/devicetree/bindings/media/i2c/samsung,s5k5f1.yaml
```yaml
# SPDX-License-Identifier: (GPL-2.0-only OR BSD-2-Clause)
%YAML 1.2
---
$id: http://devicetree.org/schemas/media/i2c/samsung,s5k5f1.yaml#
$schema: http://devicetree.org/meta-schemas/core.yaml#

title: Samsung S5K5F1 Sensor

maintainers:
  - William Floyd <git@notmy.space>

description:
  S5K5F1 is a Samsung monochrome CMOS image sensor with a 2400x2400 active
  array, sensitive into the near infrared and used as an iris-recognition
  camera in mobile devices. It is programmable over I2C and sends 8-bit
  greyscale image data over MIPI CSI-2 D-PHY on two data lanes. The
  infrared illuminator it is paired with is a separate device.

properties:
  compatible:
    const: samsung,s5k5f1

  reg:
    maxItems: 1

  clocks:
    description: Input clock, 24MHz
    maxItems: 1

  vio-supply:
    description: Interface power supply (1.8V).

  vdig-supply:
    description: Digital core power supply (1.05V).

  vana-supply:
    description: Analog power supply (2.8V).

  reset-gpios:
    description: Reference to the GPIO connected to the XCLR pin, if any.
    maxItems: 1

  orientation: true

  rotation: true

  port:
    additionalProperties: false
    $ref: /schemas/graph.yaml#/$defs/port-base

    properties:
      endpoint:
        $ref: /schemas/media/video-interfaces.yaml#
        unevaluatedProperties: false

        properties:
          data-lanes:
            maxItems: 2
          link-frequencies: true

        required:
          - data-lanes
          - link-frequencies

    required:
      - endpoint

required:
  - compatible
  - reg
  - clocks
  - port

additionalProperties: false

examples:
  - |
    #include <dt-bindings/gpio/gpio.h>

    i2c {
        #address-cells = <1>;
        #size-cells = <0>;

        camera@10 {
            compatible = "samsung,s5k5f1";
            reg = <0x10>;

            clocks = <&cam_clk>;

            vio-supply = <&cam_vio>;
            vdig-supply = <&cam_vdig>;
            vana-supply = <&cam_vana>;

            reset-gpios = <&tlmm 44 GPIO_ACTIVE_LOW>;

            orientation = <0>;
            rotation = <90>;

            port {
                endpoint {
                    remote-endpoint = <&csiphy3_ep>;
                    data-lanes = <1 2>;
                    link-frequencies = /bits/ 64 <768000000>;
                };
            };
        };
    };

...
```

## Documentation/devicetree/bindings/media/i2c/sony,imx320.yaml
```yaml
# SPDX-License-Identifier: (GPL-2.0-only OR BSD-2-Clause)
%YAML 1.2
---
$id: http://devicetree.org/schemas/media/i2c/sony,imx320.yaml#
$schema: http://devicetree.org/meta-schemas/core.yaml#

title: Sony IMX320 Sensor

maintainers:
  - William Floyd <git@notmy.space>

description:
  IMX320 is a Sony CMOS active pixel digital image sensor with an 8 Mpixel
  active array, used as a front-facing camera in mobile devices. It is
  programmable over I2C and sends image data over MIPI CSI-2 D-PHY on two
  data lanes.

properties:
  compatible:
    const: sony,imx320

  reg:
    description: I2C address
    maxItems: 1

  clocks:
    description: Input clock, 24MHz
    maxItems: 1

  vana-supply:
    description: Analog power supply (2.8V).

  vio-supply:
    description: Interface power supply (1.8V).

  vcore-supply:
    description: Digital core power supply (1.05V).

  reset-gpios:
    description: Reference to the GPIO connected to the XCLR pin, if any.
    maxItems: 1

  orientation: true

  rotation: true

  port:
    additionalProperties: false
    $ref: /schemas/graph.yaml#/$defs/port-base

    properties:
      endpoint:
        $ref: /schemas/media/video-interfaces.yaml#
        unevaluatedProperties: false

        properties:
          data-lanes:
            maxItems: 2
          link-frequencies: true

        required:
          - data-lanes
          - link-frequencies

    required:
      - endpoint

required:
  - compatible
  - reg
  - clocks
  - port

additionalProperties: false

examples:
  - |
    #include <dt-bindings/gpio/gpio.h>

    i2c {
        #address-cells = <1>;
        #size-cells = <0>;

        camera@10 {
            compatible = "sony,imx320";
            reg = <0x10>;

            clocks = <&cam_clk>;

            vana-supply = <&cam_vana>;
            vio-supply = <&cam_vio>;
            vcore-supply = <&cam_vcore>;

            reset-gpios = <&tlmm 12 GPIO_ACTIVE_LOW>;

            orientation = <0>;
            rotation = <270>;

            port {
                endpoint {
                    remote-endpoint = <&csiphy2_ep>;
                    data-lanes = <1 2>;
                    link-frequencies = /bits/ 64 <172500000 681000000
                                                  738000000>;
                };
            };
        };
    };

...
```

## Documentation/devicetree/bindings/media/i2c/sony,imx345.yaml
```yaml
# SPDX-License-Identifier: (GPL-2.0-only OR BSD-2-Clause)
%YAML 1.2
---
$id: http://devicetree.org/schemas/media/i2c/sony,imx345.yaml#
$schema: http://devicetree.org/meta-schemas/core.yaml#

title: Sony IMX345 Sensor

maintainers:
  - William Floyd <git@notmy.space>

description:
  IMX345 is a Sony CMOS active pixel digital image sensor with a 12 Mpixel
  active array, used as a rear-facing camera in mobile devices. It is
  programmable over I2C and sends image data over MIPI CSI-2 D-PHY on four
  data lanes.

  Besides the usual analog, interface and digital core rails the sensor needs
  three further supplies, without which it does not respond to I2C at all.
  What they feed is undocumented; the names mirror those the vendor firmware
  uses. The module carries three more rails again, but those belong to the OIS
  and the actuator rather than to the sensor.

properties:
  compatible:
    const: sony,imx345

  reg:
    description: I2C address
    maxItems: 1

  clocks:
    description: Input clock, 24MHz
    maxItems: 1

  vana-supply:
    description: Analog power supply (3.2V).

  vio-supply:
    description: Interface power supply (1.8V).

  vdig-supply:
    description: Digital core power supply (1.0V).

  vcustom1-supply:
    description: Additional module supply (2.85V).

  vcustom2-supply:
    description: Additional module supply (1.1V).

  vcustom10-supply:
    description: Additional module supply (1.1V).

  reset-gpios:
    description: Reference to the GPIO connected to the XCLR pin, if any.
    maxItems: 1

  orientation: true

  rotation: true

  port:
    additionalProperties: false
    $ref: /schemas/graph.yaml#/$defs/port-base

    properties:
      endpoint:
        $ref: /schemas/media/video-interfaces.yaml#
        unevaluatedProperties: false

        properties:
          data-lanes:
            maxItems: 4
          link-frequencies: true

        required:
          - data-lanes
          - link-frequencies

    required:
      - endpoint

required:
  - compatible
  - reg
  - clocks
  - port

additionalProperties: false

examples:
  - |
    #include <dt-bindings/gpio/gpio.h>

    i2c {
        #address-cells = <1>;
        #size-cells = <0>;

        camera@1a {
            compatible = "sony,imx345";
            reg = <0x1a>;

            clocks = <&cam_clk>;

            vio-supply = <&cam_vio>;
            vdig-supply = <&cam_vdig>;
            vcustom1-supply = <&cam_v_custom1>;
            vcustom2-supply = <&cam_v_custom2>;
            vana-supply = <&cam_vana>;
            vcustom10-supply = <&cam_v_custom10>;

            reset-gpios = <&tlmm 25 GPIO_ACTIVE_LOW>;

            orientation = <1>;
            rotation = <90>;

            port {
                endpoint {
                    remote-endpoint = <&csiphy0_ep>;
                    data-lanes = <1 2 3 4>;
                    link-frequencies = /bits/ 64 <675000000 702000000>;
                };
            };
        };
    };

...
```

## Documentation/devicetree/bindings/media/i2c/techwell,tw9990.yaml
```yaml
# SPDX-License-Identifier: (GPL-2.0-only OR BSD-2-Clause)
%YAML 1.2
---
$id: http://devicetree.org/schemas/media/i2c/techwell,tw9990.yaml#
$schema: http://devicetree.org/meta-schemas/core.yaml#

title: Techwell TW9990 NTSC/PAL/SECAM video decoder

maintainers:
  - William Floyd <git@notmy.space>

description:
  Automotive analog video decoder (now Renesas) with single-ended or
  differential CVBS and S-Video inputs and an 8-bit BT.601/BT.656 output of
  interlaced fields.

properties:
  compatible:
    const: techwell,tw9990

  reg:
    description: 0x44, or 0x45 when the SIAD0 strap on VD0 is pulled high.
    enum: [0x44, 0x45]

  reset-gpios:
    description: RSTB, active low.
    maxItems: 1

  powerdown-gpios:
    description: PDN, active high.
    maxItems: 1

  port:
    $ref: /schemas/graph.yaml#/properties/port
    description: Video output.

required:
  - compatible
  - reg

additionalProperties: false

examples:
  - |
    #include <dt-bindings/gpio/gpio.h>

    i2c {
        #address-cells = <1>;
        #size-cells = <0>;

        video-decoder@44 {
            compatible = "techwell,tw9990";
            reg = <0x44>;
            reset-gpios = <&pinctrl 30 GPIO_ACTIVE_LOW>;

            port {
                tw9990_out: endpoint {
                    remote-endpoint = <&rearview_in>;
                };
            };
        };
    };
```
