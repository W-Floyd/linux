## Documentation/devicetree/bindings/arm/telechips/tcc803x.yaml
```yaml
# SPDX-License-Identifier: (GPL-2.0-only OR BSD-2-Clause)
%YAML 1.2
---
$id: http://devicetree.org/schemas/arm/telechips/tcc803x.yaml#
$schema: http://devicetree.org/meta-schemas/core.yaml#

title: Telechips TCC803x SoC based Platforms

maintainers:
  - William Floyd <git@notmy.space>

description:
  Boards with a Telechips TCC803x SoC shall have the following properties.

properties:
  $nodename:
    const: '/'
  compatible:
    items:
      - enum:
          - telechips,tcc803x-avn # Telechips TCC803x AVN (Audio Video Navigation) reference board
      - const: telechips,tcc803x

additionalProperties: true

...
```

## Documentation/devicetree/bindings/clock/telechips,tcc803x-ckc.yaml
```yaml
# SPDX-License-Identifier: (GPL-2.0-only OR BSD-2-Clause)
%YAML 1.2
---
$id: http://devicetree.org/schemas/clock/telechips,tcc803x-ckc.yaml#
$schema: http://devicetree.org/meta-schemas/core.yaml#

title: Telechips TCC803x Clock Controller (CKC)

maintainers:
  - William Floyd <git@notmy.space>

description: |
  The TCC803x CKC ("Clock Controller") is the SoC's central clock
  generation block: PLLs, top-level bus clocks (FBUS_*) and gated
  peripheral clocks (PERI_*), each PERI_* channel selected by a 4-byte
  PCLKCTRL register at a fixed per-channel offset.

  This binding currently covers the PERI_* peripheral-clock gates and
  the DDIBUS_* display-bus power-down/reset gates (a second, separate
  register window -- see "reg" below). The vendor CKC also owns PLL
  configuration, the FBUS_* bus clocks, the PMU-resident ISOIP_* gates,
  and separate I/O-bus/video-bus/HSIO-bus power-down and reset gate
  arrays that live in other register regions entirely -- none of that
  is modeled yet.

  Confirmed against the real vendor Linux 3.18 tree
  (AVNT5W_TCC803XKK_kernel, Hyundai Mobis supplier-portal release,
  Telechips Inc., GPLv2):
    drivers/clk/tcc/clk-tcc803x-a7s-reg.h (CKC_* register offsets)
    drivers/clk/tcc/clk-tcc803x-a7s.c (register access patterns)
    arch/arm/boot/dts/tcc/tcc803x.dtsi:719-736 (ckc@14000000 node)

  See also: include/dt-bindings/clock/telechips,tcc803x-clks.h

properties:
  compatible:
    const: telechips,tcc803x-ckc

  reg:
    minItems: 1
    maxItems: 2
    description: |
      reg[0]: the CKC's base register block (CLKCTRL/PLL/SWRESET/
      PCLKCTRL arrays). The vendor's own devicetree declares this region
      as 0x14000000, size 0x1A8 (arch/arm/boot/dts/tcc/tcc803x.dtsi:721),
      but by the vendor driver's own offset formula (CKC_PCLKCTRL
      0xD0 + id*4, clk-tcc803x-a7s.c:1371) PERI_UART0 (id 58) sits at
      offset 0x1B8 -- past the end of that declared 0x1A8-byte window.
      This is an inconsistency in the vendor source itself, not
      something introduced here; this binding's example below sizes
      the region to actually cover PERI_UART0's register instead of
      reproducing the vendor's (apparently too-small) value.

      reg[1] (optional, required for the DDIBUS_* gates): the separate
      "display bus configuration" window, vendor tcc803x.dtsi:726
      (0x12380000, size 0x8). DDIBUS_PWDN/DDIBUS_RESET
      (clk-tcc803x-a7s-reg.h:58-59) live here, not in reg[0].

  reg-names:
    minItems: 1
    items:
      - const: ckc
      - const: ddibus

  clocks:
    items:
      - description: Crystal reference (XIN)

  clock-names:
    items:
      - const: xin

  "#clock-cells":
    const: 1
    description:
      Cell is a PERI_* channel index, or a TCC803X_CLK_DDIBUS_* onecell
      ID (a mainline-only remapping of the vendor DDIBUS_* bit number,
      not a raw vendor value -- see telechips,tcc803x-clks.h), as
      defined in include/dt-bindings/clock/telechips,tcc803x-clks.h.
      Only the channels implemented by the driver resolve to a real
      clock.

required:
  - compatible
  - reg
  - clocks
  - clock-names
  - "#clock-cells"

additionalProperties: false

examples:
  - |
    clock-controller@14000000 {
        compatible = "telechips,tcc803x-ckc";
        reg = <0x14000000 0x1bc>, <0x12380000 0x8>;
        reg-names = "ckc", "ddibus";
        clocks = <&xin>;
        clock-names = "xin";
        #clock-cells = <1>;
    };
...
```

## Documentation/devicetree/bindings/clock/telechips,tcc803x-fbus.yaml
```yaml
# SPDX-License-Identifier: (GPL-2.0-only OR BSD-2-Clause)
%YAML 1.2
---
$id: http://devicetree.org/schemas/clock/telechips,tcc803x-fbus.yaml#
$schema: http://devicetree.org/meta-schemas/core.yaml#

title: Telechips TCC803x CPU and bus clocks behind the secure monitor

maintainers:
  - William Floyd <git@notmy.space>

description: |
  The CLKCTRL channels (CPU, memory, GPU, video and I/O buses) and the clock
  gates of the IOBUS, VPUBUS and ISOTOP. On the Cortex-A53 the vendor kernel
  reaches them only through SiP SMC calls; the node has no registers. For now
  the driver only asks the monitor for their state and times the CPU, to
  check what the previous kernel left running.

properties:
  compatible:
    const: telechips,tcc803x-fbus

required:
  - compatible

additionalProperties: false

examples:
  - |
    clock-fbus {
        compatible = "telechips,tcc803x-fbus";
    };
```

## Documentation/devicetree/bindings/clock/telechips,tcc803x-sipclk.yaml
```yaml
# SPDX-License-Identifier: (GPL-2.0-only OR BSD-2-Clause)
%YAML 1.2
---
$id: http://devicetree.org/schemas/clock/telechips,tcc803x-sipclk.yaml#
$schema: http://devicetree.org/meta-schemas/core.yaml#

title: Telechips TCC803x audio clocks behind the secure monitor

maintainers:
  - William Floyd <git@notmy.space>

description: |
  The audio peripheral clocks (MDAI, MFLT, SRCH, MSPDIF), the I/O-bus
  gates of the audio blocks (ADMA, DAI, SPDIF) and the video-bus gates of the
  CODA codec. On the Cortex-A53 the vendor kernel reaches them only through
  SiP SMC calls; the node has no registers.
  Indices: include/dt-bindings/clock/telechips,tcc803x-clks.h
  (TCC803X_SIPCLK_*).

properties:
  compatible:
    const: telechips,tcc803x-sipclk

  '#clock-cells':
    const: 1

  telechips,read-only:
    type: boolean
    description:
      Enable, disable and set-rate do nothing; only the state queries reach
      the monitor. Leaves the clock tree as the previous kernel left it. Not
      for the video-bus gates, which a codec needs enabled for real.

required:
  - compatible
  - '#clock-cells'

additionalProperties: false

examples:
  - |
    clock-controller {
        compatible = "telechips,tcc803x-sipclk";
        #clock-cells = <1>;
        telechips,read-only;
    };
```

## Documentation/devicetree/bindings/display/bridge/telechips,tcc803x-hdmi.yaml
```yaml
# SPDX-License-Identifier: (GPL-2.0-only OR BSD-2-Clause)
%YAML 1.2
---
$id: http://devicetree.org/schemas/display/bridge/telechips,tcc803x-hdmi.yaml#
$schema: http://devicetree.org/meta-schemas/core.yaml#

title: Telechips TCC803x DesignWare HDMI TX Encoder

maintainers:
  - William Floyd <git@notmy.space>

description: |
  The TCC803x HDMI transmitter is a Synopsys DesignWare HDMI TX controller
  (dw-hdmi) IP core. Identification confirmed from the vendor driver source
  (Telechips AVNT5W_TCC803XKK_kernel, GPLv2, Hyundai Mobis supplier-portal
  release): Synopsys copyright headers and "dwc_hdmi_*"-prefixed functions
  throughout drivers/char/hdmi_v2_0/, and the vendor's own board DT already
  spells out compatible = "telechips,dw-hdmi-tx" for this exact node
  (arch/arm/boot/dts/tcc/tcc803x.dtsi:2872 in that tree).

  The companion PHY is reached through a Telechips-specific MMIO register
  window (the "hdmi_phy" reg region) rather than the controller's internal
  I2C PHY master that most dw-hdmi platforms use -- see
  drivers/char/hdmi_v2_0/hdmi_api_lib/src/phy/phy_803x.c in that same
  vendor tree (hdmi_phy_write()/hdmi_phy_read() do byte-wide iowrite32/
  ioread32 against this window). This is wired up as dw-hdmi's "vendor PHY"
  mechanism (struct dw_hdmi_phy_ops), the same mechanism Amlogic's
  meson_dw_hdmi.c uses for its own non-I2C PHY.

  Does not reference the common synopsys,dw-hdmi.yaml schema: its
  reg/clocks/interrupts caps (1 reg, <=5 clocks named iahb/isfr, 1
  interrupt) are sized for the minimal AHB/APB-clock integration most
  dw-hdmi platforms use, not this SoC's full vendor register/clock/IRQ
  set (CEC, HDCP1.4/2.2, DDI bus clock, etc.) -- allOf-ing it in would
  only narrow this schema, never widen it.

properties:
  compatible:
    const: telechips,tcc803x-hdmi

  reg:
    minItems: 3
    maxItems: 4

  reg-names:
    minItems: 3
    items:
      - const: hdmi_link
      - const: hdcp_2.2
      - const: hdmi_phy
      - const: i2c_port_cfg

  reg-io-width:
    const: 4

  interrupts:
    minItems: 1
    maxItems: 2

  interrupt-names:
    minItems: 1
    items:
      - const: hdmi_link
      - const: hdcp_2.2

  clocks:
    minItems: 6
    maxItems: 8

  clock-names:
    minItems: 6
    items:
      - const: hdmi_ref_clk
      - const: hdmi_spdif_clk
      - const: hdmi_apb_clk
      - const: hdmi_cec
      - const: hdmi_hdcp14
      - const: hdmi_hdcp22
      - const: hdmi_ddibus
      - const: hdmi_isoip_ddibus

  telechips,ref-clock-source:
    description: |
      HDMI reference clock source select, matching the vendor's own
      hdmi_ref_src_clock board property (drivers/char/hdmi_v2_0/hdmi_tx.c
      in the vendor tree). Not yet backed by real CKC clock IDs in
      mainline (see the clocks note below) -- kept as a raw selector
      property, same value space as the vendor's own property, until the
      corresponding clock-controller support exists to express this as an
      actual "clocks" phandle/assigned-clock-parent instead.
    $ref: /schemas/types.yaml#/definitions/uint32
    enum: [0, 1, 2, 3]

  telechips,phy-type:
    description: |
      Companion PHY selection, matching the vendor's own hdmi_phy_type
      board property. 0 selects PHY 8980, 1 selects PHY 8985 (vendor
      drivers/char/hdmi_v2_0/include/hdmi_includes.h comment, "0 8980, 1
      8985").
    $ref: /schemas/types.yaml#/definitions/uint32
    enum: [0, 1]

required:
  - compatible
  - reg
  - reg-names
  - reg-io-width
  - interrupts

unevaluatedProperties: false

examples:
  - |
    #include <dt-bindings/interrupt-controller/arm-gic.h>

    soc {
      #address-cells = <1>;
      #size-cells = <1>;

      hdmi-tx@12400000 {
        compatible = "telechips,tcc803x-hdmi";
        reg = <0x12400000 0x20000>, <0x12440000 0x1000>,
              <0x12480000 0x1000>, <0x163c0000 0x10>;
        reg-names = "hdmi_link", "hdcp_2.2", "hdmi_phy", "i2c_port_cfg";
        reg-io-width = <4>;
        interrupts = <GIC_SPI 123 IRQ_TYPE_LEVEL_HIGH>,
                     <GIC_SPI 126 IRQ_TYPE_LEVEL_HIGH>;
        interrupt-names = "hdmi_link", "hdcp_2.2";
        telechips,ref-clock-source = <0>;
        telechips,phy-type = <0>;
      };
    };

...
```

## Documentation/devicetree/bindings/display/telechips/telechips,tcc803x-lvds-panel.yaml
```yaml
# SPDX-License-Identifier: (GPL-2.0-only OR BSD-2-Clause)
%YAML 1.2
---
$id: http://devicetree.org/schemas/display/telechips/telechips,tcc803x-lvds-panel.yaml#
$schema: http://devicetree.org/meta-schemas/core.yaml#

title: Telechips TCC803x AVN main panel, LVDS output

maintainers:
  - William Floyd <git@notmy.space>

description: |
  Same physical panel as telechips,tcc803x-mrgb-panel.yaml -- same
  board, same 1920x720 touch-coordinate-matched dimensions, same
  live-captured DISP0 timing (LHTIME1/2, LVTIME1/2, each field plus one,
  per drivers/gpu/drm/telechips/tcc803x_drm_vioc.c's bitfield layout, which
  DISP0 generates and this output path passes through unmodified
  regardless of whether it leaves the SoC via MRGB pins or the on-die
  LVDS PHY). A separate compatible string instead of reusing
  "telechips,tcc803x-mrgb-panel" because the two describe genuinely
  different output stages (MISCCFG mux pins vs. lvds_phy serializer)
  even though the panel glass and timing are identical -- see
  telechips,tcc803x-mrgb-panel.yaml's description for the full
  LVDS-vs-MRGB evidence trail, which this binding does not repeat.

  Timing as in the MRGB binding.

properties:
  compatible:
    const: telechips,tcc803x-lvds-panel

  width-mm:
    const: 92

  height-mm:
    const: 243

  port:
    $ref: /schemas/graph.yaml#/properties/port
    description:
      Not connected in this board's DT and not referenced by
      drivers/gpu/drm/bridge/tcc803x-lvds.c, which is a terminal
      bridge (no drm_panel exists for this compatible string yet --
      see that driver's header). Present for schema completeness and
      so the real panel dimensions/timing have somewhere honest to
      live, same role mrgb_panel plays for the MRGB path.

  panel-timing:
    type: object
    properties:
      clock-frequency:
        const: 99700000
      hactive:
        const: 1920
      vactive:
        const: 720
      hsync-len:
        const: 32
      hfront-porch:
        const: 50
      hback-porch:
        const: 160
      vsync-len:
        const: 5
      vfront-porch:
        const: 15
      vback-porch:
        const: 28
      hsync-active:
        const: 1
      vsync-active:
        const: 1
    required:
      - clock-frequency
      - hactive
      - vactive
      - hsync-len
      - hfront-porch
      - hback-porch
      - vsync-len
      - vfront-porch
      - vback-porch
    additionalProperties: false

required:
  - compatible
  - panel-timing

additionalProperties: false

examples:
  - |
    panel {
        compatible = "telechips,tcc803x-lvds-panel";
        width-mm = <92>;
        height-mm = <243>;

        panel-timing {
            clock-frequency = <99700000>;
            hactive = <1920>;
            vactive = <720>;
            hsync-len = <32>;
            hfront-porch = <50>;
            hback-porch = <160>;
            vsync-len = <5>;
            vfront-porch = <15>;
            vback-porch = <28>;
            hsync-active = <1>;
            vsync-active = <1>;
        };
    };

...
```
