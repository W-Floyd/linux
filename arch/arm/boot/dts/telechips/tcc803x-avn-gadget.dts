// SPDX-License-Identifier: GPL-2.0
/*
 * tcc803x-avn with the USB-A port in peripheral mode (ethernet-over-USB to a
 * computer). The port's PHY is shared: an OTGMUX register hands it to either
 * the EHCI/OHCI pair behind the mux or the DWC2 core, so the host pair is
 * disabled here and the stick plugged into this port is not seen. Boot from
 * RAM (initramfs) or from a stick on the other host pair, if it is wired out.
 *
 * The role is fixed, with the B-session forced valid (usb-role-switch +
 * default mode), because VBUS sensing and the ID pin are unwired/unknown.
 *
 * VBUS: the stock "vbus on|off" on dwc_otg drives gpa 28 through the PHY's
 * set_vbus, inverted under CONFIG_WIDE_PE_COMMON (phy-tcc-dwc_otg.c:82-86),
 * so off is physically high. WIDE_PE_COMMON is inferred (this board's DT has
 * charger-ctrl-able, which needs it) but not confirmed against the shipped
 * .config: if the polarity is wrong the PHY probe turns VBUS on. Check gpa 28
 * with the stock "vbus off" before relying on it.
 */

#include "tcc803x-avn.dts"

&ehci_mux {
	status = "disabled";
};

&ohci_mux {
	status = "disabled";
};

&dwc_otg_phy {
	vbus-gpios = <&pinctrl 28 GPIO_ACTIVE_LOW>;
	status = "okay";
};

&dwc_otg {
	dr_mode = "peripheral";
	usb-role-switch;
	role-switch-default-mode = "peripheral";
	status = "okay";
};
